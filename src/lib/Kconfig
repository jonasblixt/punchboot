## src/plat/imx6ul/Kconfig
```kconfig
menu "Output image"
    depends on PLAT_IMX6UL

config IMX6UL_CREATE_IMX_IMAGE
    bool "Create pb.imx"
    help
        pb.imx, the image the boot ROM loads (plat-imx.md 6).

config IMX6UL_SIGN_IMAGE
    bool "Sign it (HABv4)"
    depends on IMX6UL_CREATE_IMX_IMAGE
    help
        pb_signed.imx, and pb_signed_uuu.imx for the serial downloader,
        signed for HABv4 with NXP's cst (plat-imx.md 6).

config IMX6UL_SRK_TABLE
    string "SRK table"
    default "pki/imx6ul_hab_testkeys/SRK_1_2_3_4_table.bin"
    depends on IMX6UL_SIGN_IMAGE

config IMX6UL_KEY_INDEX
    int "Key index (0-3)"
    default 0
    depends on IMX6UL_SIGN_IMAGE

config IMX6UL_SIGN_CERT
    string "CSF signing certificate"
    default "pki/imx6ul_hab_testkeys/CSF1_1_sha256_4096_65537_v3_usr_crt.pem"
    depends on IMX6UL_SIGN_IMAGE

config IMX6UL_IMAGE_SIGN_CERT
    string "Image signing certificate"
    default "pki/imx6ul_hab_testkeys/IMG1_1_sha256_4096_65537_v3_usr_crt.pem"
    depends on IMX6UL_SIGN_IMAGE
endmenu
```

## src/plat/imx6ul/Kconfig.cm
```kconfig
# Command mode's USB port (platform.md 3.10), in the Command mode menu

choice IMX6UL_CM_USB
    bool "Command mode's USB port"
    depends on PLAT_IMX6UL && CM
    help
        The USB device port command mode uses. plat_cm_init() sets up its
        clocks, its PHY and its controller when command mode starts
        (platform.md 3.10).

config IMX6UL_CM_USB_OTG1
    bool "USB OTG1"
    select DRIVER_USB_DEVICE
    select DRIVER_USB_PB_CLS
    select DRIVER_IMX_USB2_PHY
    select DRIVER_IMX_CI_UDC
    help
        USB OTG1, the port of the ROM's serial downloader.
endchoice
```

## src/plat/imx8m/Kconfig
```kconfig
menu "Output image"
    depends on PLAT_IMX8M_COMMON

config IMX8M_CREATE_IMX_IMAGE
    bool "Create pb.imx"
    default y
    help
        pb.imx, the image the boot ROM loads (plat-imx.md 6).

config IMX8M_SIGN_IMAGE
    bool "Sign it (HABv4, i.MX8MQ)"
    depends on IMX8M_CREATE_IMX_IMAGE && PLAT_IMX8MQ
    help
        pb_signed.imx, signed for HABv4 with NXP's cst. The i.MX8M Quad
        only: where the image header sits is the 8MQ's (plat-imx.md 6).

config IMX8M_SRK_TABLE
    string "SRK table"
    default "pki/imx6ul_hab_testkeys/SRK_1_2_3_4_table.bin"
    depends on IMX8M_SIGN_IMAGE

config IMX8M_KEY_INDEX
    int "Key index (0-3)"
    default 0
    depends on IMX8M_SIGN_IMAGE

config IMX8M_SIGN_CERT
    string "CSF signing certificate"
    default "pki/imx6ul_hab_testkeys/CSF1_1_sha256_4096_65537_v3_usr_crt.pem"
    depends on IMX8M_SIGN_IMAGE

config IMX8M_IMAGE_SIGN_CERT
    string "Image signing certificate"
    default "pki/imx6ul_hab_testkeys/IMG1_1_sha256_4096_65537_v3_usr_crt.pem"
    depends on IMX8M_SIGN_IMAGE
endmenu
```

## src/plat/imx8m/Kconfig.cm
```kconfig
# Command mode's USB port (platform.md 3.10), in the Command mode menu

choice IMX8M_CM_USB
    bool "Command mode's USB port"
    depends on PLAT_IMX8M_COMMON && CM
    help
        The USB device port command mode uses. plat_cm_init() sets up its
        clocks, its power, its PHY and its controller when command mode
        starts (platform.md 3.10).

config IMX8M_CM_USB1
    bool "USB1"
    select DRIVER_USB_DEVICE
    select DRIVER_USB_PB_CLS
    select DRIVER_IMX8M_PHY
    select DRIVER_IMX_DWC3_UDC
endchoice
```

## src/plat/imx8x/Kconfig
```kconfig
menu "i.MX8X options"
    depends on PLAT_IMX8X_COMMON

config IMX8X_FUSE_DRY_RUN
    bool "Fuse box: dry run"
    help
        Program no fuses: write each fuse's bank and value to the console
        instead.

endmenu

menu "Output image"
    depends on PLAT_IMX8X_COMMON

config IMX8X_CREATE_IMX_IMAGE
    bool "Create pb.imx"
    help
        pb.imx, the boot container with the SECO firmware, the SCU firmware
        and pb (plat-imx.md 6).

config IMX8X_SIGN_IMAGE
    bool "Sign it (AHAB)"
    depends on IMX8X_CREATE_IMX_IMAGE
    help
        pb_signed.imx, pb.imx signed for AHAB with NXP's cst.

config IMX8X_SRK_TABLE
    string "SRK table"
    default "pki/imx8x_ahab/crts/SRK_1_2_3_4_table.bin"
    depends on IMX8X_SIGN_IMAGE

config IMX8X_SIGN_CERT
    string "Signing certificate"
    default "pki/imx8x_ahab/crts/SRK1_sha384_secp384r1_v3_usr_crt.pem"
    depends on IMX8X_SIGN_IMAGE

config IMX8X_KEY_INDEX
    int "Key index (0-3)"
    default 0
    depends on IMX8X_SIGN_IMAGE

config IMX8X_KEY_REVOKE_MASK
    int "Revoked SRKs"
    default 0
    depends on IMX8X_SIGN_IMAGE
    help
        The bit mask of the revoked SRKs in the container's signature
        (Revocations in the CSF), as a decimal number.

endmenu
```

## src/plat/imx8x/Kconfig.cm
```kconfig
# Command mode's USB port (platform.md 3.10), in the Command mode menu

choice IMX8X_CM_USB
    bool "Command mode's USB port"
    depends on PLAT_IMX8X_COMMON && CM
    help
        The USB device port command mode uses. plat_cm_init() sets up its
        power, its clocks, its PHY and its controller when command mode
        starts (platform.md 3.10).

config IMX8X_CM_USB3
    bool "USB 3.0 (i.MX8QXP)"
    depends on PLAT_IMX8X
    select DRIVER_USB_DEVICE
    select DRIVER_USB_PB_CLS
    select DRIVER_IMX_CDNS3_UDC
    help
        The Cadence USB3 controller with its PHY, the SCFW's SC_R_USB_2.

config IMX8X_CM_USB_OTG2
    bool "USB OTG2 (i.MX8DXL)"
    depends on PLAT_IMX8XL
    select DRIVER_USB_DEVICE
    select DRIVER_USB_PB_CLS
    select DRIVER_IMX_USB2_PHY
    select DRIVER_IMX_CI_UDC
    help
        The second ChipIdea controller with its PHY, the SCFW's SC_R_USB_1.
endchoice
```

## src/plat/imxrt/Kconfig
```kconfig
menu "Output image"
    depends on PLAT_IMXRT

config IMXRT_CREATE_IMX_IMAGE
    bool "Create pb.imx"
    default y
    help
        pb.imx, pb.bin with the image header the boot ROM reads
        (plat-imx.md 6).

config IMXRT_CREATE_FLASH_IMAGE
    bool "Create pb_flash.bin"
    default y
    depends on IMXRT_CREATE_IMX_IMAGE
    help
        pb_flash.bin, what goes in the FlexSPI NOR from offset 0: the
        board's FlexSPI configuration block, then pb.imx at 4 KiB.
endmenu
```

## src/plat/imxrt/Kconfig.cm
```kconfig
# Command mode's USB port (platform.md 3.10), in the Command mode menu

choice IMXRT_CM_USB
    bool "Command mode's USB port"
    depends on PLAT_IMXRT && CM
    help
        The USB device port command mode uses. plat_cm_init() sets up its
        clocks, its PHY and its controller when command mode starts
        (platform.md 3.10).

config IMXRT_CM_USB_OTG1
    bool "USB OTG1"
    select DRIVER_USB_DEVICE
    select DRIVER_USB_PB_CLS
    select DRIVER_IMX_USB2_PHY
    select DRIVER_IMX_CI_UDC
endchoice
```

## testbench/Config.in
```kconfig
menu "Bootloaders"
source "$BR2_EXTERNAL_PB_TESTBENCH_PATH/boot/punchboot/Config.in"
endmenu

menu "Target packages"
source "$BR2_EXTERNAL_PB_TESTBENCH_PATH/package/bpak/Config.in"
source "$BR2_EXTERNAL_PB_TESTBENCH_PATH/package/kickstart/Config.in"
source "$BR2_EXTERNAL_PB_TESTBENCH_PATH/package/pb-watchdog/Config.in"
source "$BR2_EXTERNAL_PB_TESTBENCH_PATH/package/pbstate/Config.in"
endmenu

menu "Host utilities"
source "$BR2_EXTERNAL_PB_TESTBENCH_PATH/package/bpak/Config.in.host"
source "$BR2_EXTERNAL_PB_TESTBENCH_PATH/package/imx-cst/Config.in.host"
endmenu
```

## testbench/boot/punchboot/Config.in
```kconfig
config BR2_TARGET_PUNCHBOOT
	bool "punchboot"
	depends on BR2_arm || BR2_aarch64
	select BR2_PACKAGE_HOST_BPAK
	select BR2_PACKAGE_HOST_UBOOT_TOOLS
	help
	  punchboot, built from the punchboot tree that this test bench
	  is in.

	  https://github.com/jonasblixt/punchboot

if BR2_TARGET_PUNCHBOOT

config BR2_TARGET_PUNCHBOOT_BOARD
	string "punchboot board"
	help
	  Board directory in src/board/ of the punchboot sources.

config BR2_TARGET_PUNCHBOOT_CONFIG_FILE
	string "punchboot configuration file"
	help
	  Path to a punchboot Kconfig file. Leave empty to use
	  configs/<board>_defconfig from the punchboot sources.

config BR2_TARGET_PUNCHBOOT_IMX_HAB
	bool "HAB signed image (NXP CST)"
	select BR2_PACKAGE_HOST_IMX_CST
	help
	  The punchboot configuration signs the image for the i.MX HAB
	  (CONFIG_IMX6UL_SIGN_IMAGE), which needs NXP's cst.

config BR2_TARGET_PUNCHBOOT_IMX8M_DDR_FW
	bool "i.MX8M LPDDR4 training firmware"
	depends on BR2_PACKAGE_FIRMWARE_IMX
	help
	  Link NXP's LPDDR4 PHY training firmware from firmware-imx
	  (lpddr4_pmu_train_*<BR2_PACKAGE_FIRMWARE_IMX_DDR_VERSION>.bin)
	  into punchboot.

endif
```

## testbench/package/bpak/Config.in
```kconfig
config BR2_PACKAGE_BPAK
	bool "libbpak"
	select BR2_PACKAGE_MBEDTLS
	select BR2_PACKAGE_XZ
	help
	  The BitPacker (bpak) library, with the Mbed TLS crypto
	  backend. kickstart links it statically.

	  https://github.com/jonasblixt/bpak
```

## testbench/package/bpak/Config.in.host
```kconfig
config BR2_PACKAGE_HOST_BPAK
	bool "host bpak"
	help
	  BitPacker (bpak), the image format and tool used to create
	  and sign punchboot boot images. The bpak python package.

	  https://github.com/jonasblixt/bpak
```

## testbench/package/imx-cst/Config.in.host
```kconfig
config BR2_PACKAGE_HOST_IMX_CST
	bool "host imx-cst"
	help
	  NXP Code Signing Tool (cst, srktool) for i.MX HAB and AHAB
	  secure boot images. Built from the Debian source package.

	  https://salsa.debian.org/collabora-team/imx-code-signing-tool
```

## testbench/package/kickstart/Config.in
```kconfig
config BR2_PACKAGE_KICKSTART
	bool "kickstart"
	depends on BR2_TOOLCHAIN_USES_MUSL
	select BR2_PACKAGE_BPAK
	select BR2_PACKAGE_MBEDTLS
	help
	  The init ramdisk of punchboot: verifies the root image of the
	  booted system (A/B) and mounts it with dm-verity. Installed as
	  images/kickstart.cpio.gz, not in the root file system.

	  The init is statically linked, the C library must be musl.

	  Built from a branch of its git repository,
	  PB_TESTBENCH_KICKSTART_REPO and _BRANCH in external.mk.

	  https://github.com/jonasblixt/kickstart

if BR2_PACKAGE_KICKSTART

config BR2_PACKAGE_KICKSTART_ROOT_A
	string "root image of system A"
	help
	  Block device, KICKSTART_ROOT_A.

config BR2_PACKAGE_KICKSTART_ROOT_B
	string "root image of system B"
	help
	  Block device, KICKSTART_ROOT_B.

config BR2_PACKAGE_KICKSTART_PBSTATE_PRIMARY
	string "primary pbstate"
	help
	  Block device of punchboot's primary boot state,
	  KICKSTART_PBSTATE_PRIMARY. Optional, set both or none.

config BR2_PACKAGE_KICKSTART_PBSTATE_BACKUP
	string "backup pbstate"
	help
	  Block device of the backup boot state, KICKSTART_PBSTATE_BACKUP.

config BR2_PACKAGE_KICKSTART_KEYSTORE
	string "keystore"
	help
	  bpak keystore archive with the keys of the root images. Empty:
	  a keystore "kickstart" with punchboot's test key
	  pki/secp256r1-pub-key.pem as "pb-development".

config BR2_PACKAGE_KICKSTART_LOG_LEVEL
	string "log level"
	default "info"
	help
	  error, warning, info or debug.

endif

comment "kickstart needs a musl toolchain"
	depends on !BR2_TOOLCHAIN_USES_MUSL
```

## testbench/package/pb-watchdog/Config.in
```kconfig
config BR2_PACKAGE_PB_WATCHDOG
	bool "pb-watchdog"
	depends on !BR2_PACKAGE_BUSYBOX_WATCHDOG
	help
	  Keeps /dev/watchdog alive like BusyBox's watchdog daemon, and
	  sets a pretimeout first: with the kernel's panic pretimeout
	  governor a hang panics Linux shortly before the watchdog
	  resets the board, so ramoops saves the kernel log for
	  'punchboot log linux'.

comment "pb-watchdog replaces BusyBox's watchdog startup script"
	depends on BR2_PACKAGE_BUSYBOX_WATCHDOG
```

## testbench/package/pbstate/Config.in
```kconfig
config BR2_PACKAGE_PBSTATE
	bool "pbstate"
	help
	  Reads and changes the punchboot A/B boot state from Linux:
	  mark the running system verified, switch system. Built from
	  tools/pbstate of the punchboot tree this test bench is in.

	  https://github.com/jonasblixt/punchboot
```
