## src/drivers/fs/Kconfig
```kconfig
menu "Filesystem"

config LITTLE_FS
	bool "Enable support for littlefs"
    default n

endmenu
```

## src/drivers/gpio/Kconfig
```kconfig
menu "GPIO"

config DRIVERS_IMX_GPIO
    bool "i.MX GPIO"
    depends on SOC_FAMILY_IMX
    default y

endmenu
```

## src/kconfig/Kconfig.build
```kconfig
menu "Build configuration"

config OPTIMIZE
    string "Optimize level"

config DEBUG_SYMBOLS
    bool "Enable debug symbols"

config STACK_USAGE
    bool "Generate stack usage information"

config STACK_SIZE_KB
    int "Stack size in Kbyte"
    default 2

endmenu
```

## src/plat/qemu/Kconfig
```kconfig
menu "QEMU platform configuration"
depends on PLAT_QEMU

config QEMU_RAM_MB
    int "Memory in mb"
    default 1024

config QEMU_VIRTIO_DISK
    string "Virtio disk file"
    default "/tmp/disk"

config QEMU_VIRTIO_DISK_SIZE_MB
    int "Virtio disk size (mb)"
    default 30

config QEMU_ENABLE_TEST_COVERAGE
    bool "Enable gcov test coverage"
    default n

endmenu
```
