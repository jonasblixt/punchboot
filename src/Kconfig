## src/Kconfig
```kconfig
mainmenu "Punchboot configuration"

menu "Architecture"
source "src/arch/Kconfig"
source "src/arch/*/Kconfig"
endmenu

source "src/plat/Kconfig"

# The board being built (BOARD, see the Makefile), if it has options
osource "$(BOARD)/Kconfig"

menu "Boot"
source "src/boot/Kconfig"
endmenu

menu "Command mode"
source "src/cm/Kconfig"
# The platform's choice of the USB port (platform.md 3.10)
osource "src/plat/*/Kconfig.cm"
endmenu

menu "Keys and life cycle"

# The keys pb verifies images and command mode's tokens with are the board's
# makefile.mk's, VERIFY_KEY<n>_PATH (board.md 7, D-083)

config SRK_FUSE
    string "SRK hash fuse words"
    default ""
    help
        srktool's fuse file (e.g. SRK_1_2_3_4_fuse.bin) of the keys pb is
        signed with, for a board that fuses the SRK hash in
        slc_set_configuration() (include/pb/srk_fuse.h).

config SLC_NO_FUSE_WRITES
    bool "Never write fuses"
    help
        The product's choice (system.md 4, D-087), for a board that must
        stay as it is, such as a development board that isn't yours to
        close. On: pb writes no fuse, whatever the port can. Configuring,
        locking, revoking a key and EOL (also with SLC_EOL) answer
        NOT_SUPPORTED, the answer of a port without them
        (command-mode.md 5.2); the life cycle and the keys are still read.

        Off, the default: the port's fuse writes, in the life cycle's order.

config SLC_EOL
    bool "End of life (EOL) as a life cycle state the device can enter"
    depends on CM
    help
        The product's choice (system.md 4). On: SLC_SET_EOL moves the device
        to the SoC's end of life state through the port's set_eol, where the
        port has one. It can't be undone, and command mode is open again in
        that state (D-011).

        Off, the default: the device can't enter EOL. SLC_SET_EOL answers
        NOT_SUPPORTED and slc_set_eol() calls nothing of the port's
        (command-mode.md 4.5, 5.2). A device that is in EOL already still
        reads as that.

endmenu

menu "Logging"

config LOGLEVEL
    int "Console log level"
    default 0
    help
        What the console (UART) prints: 0 nothing, 1 errors, 2 also
        warnings and info, 3 also debug. With CONFIG_RAMLOG the RAM log has
        every level, up to debug (include/pb/log_def.h).

config PRINT_BOOT_BANNER
    bool "Boot banner"
    default y
    help
        pb's version and the boot reason on the console when it is set up.

config RAMLOG
    bool "Enable ram log"
    help
        Everything written to the console is also kept in a ring buffer in
        RAM, the symbol 'ramlog' in the .ramlog section (not zeroed, in the
        RAM pb runs from). It can be read without a UART: over JTAG,
        through a boot ROM USB loader (FEL) or from a RAM dump. The layout
        is struct pb_ramlog_hdr in include/pb/ramlog.h.

        It has every level, up to debug, also the ones above LOGLEVEL,
        which the console doesn't print: the UART can stay quiet and fast
        while the RAM log has the whole story. Those messages are compiled
        in, so pb is larger (debug adds about 8 KiB over info on jiffy).

        Output from before console_init() (early debug prints) goes only
        to the RAM log, and is written to the UART when console_init()
        sets it up. If there was more early output than the log holds,
        only the newest RAMLOG_SIZE_KiB is written out.

config RAMLOG_SIZE_KiB
    int "RAM log size (KiB)"
    default 16
    depends on RAMLOG
    help
        The log's size in RAM, its header included: the data is 16 bytes
        less (struct pb_ramlog_hdr's size field).

menuconfig BOOT_LINUX_RAMOOPS
    bool "Linux's ramoops records as the log 'linux'"
    help
        Linux's pstore/ramoops saves the kernel log in a reserved RAM region
        that survives a warm reset: a dmesg record at an oops or a panic,
        and at a reboot with max-reason = <4> in its device tree node. With
        this, 'punchboot log linux' reads the newest record, with its
        "====<sec>.<usec>-D" header (the time Linux saved it), e.g. after a
        panic and a watchdog reset into command mode. Records must not be
        compressed (CONFIG_PSTORE_COMPRESS off in Linux). pb only reads the
        region, before anything is loaded into it, and the values must
        match the ramoops node in the device tree (reserved-memory,
        ecc-size 0). A cold reset (power, or a PMIC that power cycles the
        DRAM) loses it. The log is only read through command mode, so
        command mode sets it up, not the boot.

config BOOT_LINUX_RAMOOPS_ADDR
    hex "Region address (reg)"
    depends on BOOT_LINUX_RAMOOPS

config BOOT_LINUX_RAMOOPS_SIZE
    hex "Region size (reg)"
    depends on BOOT_LINUX_RAMOOPS

config BOOT_LINUX_RAMOOPS_RECORD_SIZE
    hex "record-size"
    depends on BOOT_LINUX_RAMOOPS

config BOOT_LINUX_RAMOOPS_CONSOLE_SIZE
    hex "console-size"
    depends on BOOT_LINUX_RAMOOPS
    default 0x0

config BOOT_LINUX_RAMOOPS_FTRACE_SIZE
    hex "ftrace-size"
    depends on BOOT_LINUX_RAMOOPS
    default 0x0

config BOOT_LINUX_RAMOOPS_PMSG_SIZE
    hex "pmsg-size"
    depends on BOOT_LINUX_RAMOOPS
    default 0x0

endmenu

menu "Core"

comment "Watchdog"

config ENABLE_WATCHDOG
    bool "Watchdog"
    default y
    help
        The platform arms the SoC's watchdog in plat_early_init(), and pb
        kicks it while it works. Speculative mode needs it.

config WATCHDOG_TIMEOUT
    int "Timeout (s)"
    default 5
    range 1 127
    depends on ENABLE_WATCHDOG
    help
        What every platform's watchdog takes as it is (F-416). The i.MX
        WDOG (6UL, 8M, RT) counts half seconds in eight bits: n s is
        n + 0.5 s, and a longer one was clamped to 128 s, 0 to 0.5 s. The
        8X's SCFW takes milliseconds; Linux's driver for it stops at
        128 s. Kconfig keeps a value outside the range from a defconfig
        out with a warning, so tests/unit/check_watchdog_kconfig.py
        checks every configs/*_defconfig against it.

comment "Limits"

config CRYPTO_MAX_HASH_OPS
    int "Hash backends, at most"
    default 1
    help
        How many hash implementations can be registered (pb/crypto.h).

config CRYPTO_MAX_DSA_OPS
    int "Signature (DSA) backends, at most"
    default 1
    help
        How many signature verification implementations can be
        registered (pb/crypto.h).

config BIO_MAX_DEVS
    int "Block devices, at most"
    default 32

config BIO_MAX_BLOCK_SIZE
    int "Largest block size (bytes)"
    default 4096
    help
        A block device with larger blocks is refused when it is registered
        (bio.md 2.3).

endmenu

menu "Drivers"
source "src/drivers/*/Kconfig"
endmenu

source "src/lib/Kconfig"

menu "Hacks"

comment "Development hacks: never in a product's build"

config HACK_PEEK
    bool "peek: read memory over command mode"
    help
        A named command, peek, that answers memory at an address as text,
        for the command line: punchboot cmd peek "0x960 16". The request is
        an address and a length in bytes (decimal or 0x hex, multiples of
        4, the length 4 without one); the response is 32-bit words, 16
        bytes a line, as many lines as fit (about 1.4 KiB from punchboot).
        For finding what a SoC's ROM leaves in its on-chip RAM (its event
        log, its boot information) where the manual doesn't say.

        With an MMU only what pb maps is read (pb_mmu_mapped()): the
        DRAM, the platform's regions, the board's, pb itself; a platform
        may map more of its on-chip RAM for it (the i.MX8M: OCRAM_S and
        the TCM below pb; the i.MX8X: the OCRAM and the SCU's TCM, whose
        read faults). Without an MMU (ARMv7-M) any address is read, and
        one with nothing there faults.

        It reads memory the secure world may own, and a locked device
        answers it after authentication like any command: never in a
        product's build.

endmenu

menu "Build"

choice EXECUTE
    bool "pb runs from"
config EXECUTE_IN_RAM
    bool "RAM"
config EXECUTE_IN_FLASH
    bool "Flash (XIP)"
endchoice

config OPTIMIZE
    string "Optimization level"
    help
        What follows -O: 0, 1, 2, 3, s, z or g.

config DEBUG_SYMBOLS
    bool "Debug symbols (-g)"

config STACK_SIZE_KiB
    int "Stack size (KiB)"
    default 2

config LINK_FILE
    string "Link script"
    default "src/link.lds" if EXECUTE_IN_RAM
    default "src/link_flash.lds" if EXECUTE_IN_FLASH
    help
        pb's sections. The platform's link script, with the memory, comes
        before it (platform.md 5.1).

endmenu
```

## src/plat/Kconfig
```kconfig
menu "Platform support"

config SOC_FAMILY_IMX
    bool "NXP i.MX SoCs"

config PLAT_IMX8X_COMMON
    bool
    select HAVE_IMX_CAAM
    select HAVE_IMX_LPUART
    select HAVE_IMX_CI_UDC

# Shared by the i.MX8M SoCs: platform code in src/plat/imx8m, DDR drivers
config PLAT_IMX8M_COMMON
    bool
    select DRIVERS_DDR_UMCTL2
    select DRIVERS_DDR_DWC_PHY
    select DRIVERS_TZC380
    select DRIVERS_IMX_ROM_LOG
    select DRIVERS_IMX_HAB_LOG
    select HAVE_IMX_CAAM
    select HAVE_IMX_OCOTP
    select HAVE_IMX_UART
    select HAVE_IMX_WDOG
    select HAVE_IMX_DWC3_UDC

choice PLAT
    bool "Platform"
config PLAT_IMX8X
    bool "NXP i.MX8QXP (i.MX8X)"
    depends on SOC_FAMILY_IMX
    depends on ARCH_ARMV8
    select PLAT_IMX8X_COMMON
    select HAVE_IMX_CDNS3_UDC
config PLAT_IMX8XL
    bool "NXP i.MX8DXL (i.MX8X)"
    depends on SOC_FAMILY_IMX
    depends on ARCH_ARMV8
    select PLAT_IMX8X_COMMON
config PLAT_IMX8MQ
    bool "NXP i.MX8MQ"
    depends on SOC_FAMILY_IMX
    depends on ARCH_ARMV8
    select PLAT_IMX8M_COMMON
config PLAT_IMX8MP
    bool "NXP i.MX8M Plus"
    depends on SOC_FAMILY_IMX
    depends on ARCH_ARMV8
    select PLAT_IMX8M_COMMON
config PLAT_IMX6UL
    bool "NXP i.MX6UL"
    depends on SOC_FAMILY_IMX
    depends on ARCH_ARMV7
    select DRIVERS_TZC380
    select DRIVERS_IMX_ROM_LOG
    select DRIVERS_IMX_HAB_LOG
    select HAVE_IMX_CAAM
    select HAVE_IMX_OCOTP
    select HAVE_IMX_UART
    select HAVE_IMX_WDOG
    select HAVE_IMX_CI_UDC
config PLAT_IMXRT
    bool "NXP i.MX RT"
    depends on SOC_FAMILY_IMX
    depends on ARCH_ARMV7M
    select DRIVERS_IMX_HAB_LOG
    select HAVE_IMX_OCOTP
    select HAVE_IMX_LPUART
    select HAVE_IMX_WDOG
    select HAVE_IMX_CI_UDC

config PLAT_HOST
    bool "Host (native Linux process, for testing)"
    depends on ARCH_HOST
endchoice

source "src/plat/*/Kconfig"

endmenu
```

## src/plat/imx8m/Kconfig.cm
```kconfig
# Command mode's USB port (platform.md 3.10), in the Command mode menu

choice IMX8M_CM_USB
    bool "USB port"
    depends on PLAT_IMX8M_COMMON && CM
    help
        The USB device port command mode uses. plat_cm_init() sets up its
        clocks, its power, its PHY and its controller when command mode
        starts (platform.md 3.10).

config IMX8M_CM_USB1
    bool "USB1"
    select DRIVER_USB_DEVICE
    select DRIVER_USB_PB_CLS
    select DRIVER_IMX8M_PHY
    select DRIVER_IMX_DWC3_UDC
    help
        USB1, the port of the ROM's serial downloader on the i.MX8MQ, and
        one of the two on the i.MX8M Plus.

config IMX8M_CM_USB2
    bool "USB2 (i.MX8M Plus)"
    depends on PLAT_IMX8MP
    select DRIVER_USB_DEVICE
    select DRIVER_USB_PB_CLS
    select DRIVER_IMX8M_PHY
    select DRIVER_IMX_DWC3_UDC
    help
        USB2, the i.MX8M Plus's second port of the ROM's serial downloader
        (RM 6.1.7). No board in the tree uses it.
endchoice
```

## src/plat/imx8x/Kconfig.cm
```kconfig
# Command mode's USB port (platform.md 3.10), in the Command mode menu

choice IMX8X_CM_USB
    bool "USB port"
    depends on PLAT_IMX8X_COMMON && CM
    help
        The USB device port command mode uses. plat_cm_init() sets up its
        power, its clocks, its PHY and its controller when command mode
        starts (platform.md 3.10).

config IMX8X_CM_USB3
    bool "USB 3.0 (i.MX8QXP)"
    depends on PLAT_IMX8X
    select DRIVER_USB_DEVICE
    select DRIVER_USB_PB_CLS
    select DRIVER_IMX_CDNS3_UDC
    help
        The Cadence USB3 controller with its PHY, the SCFW's SC_R_USB_2.

config IMX8X_CM_USB_OTG1
    bool "USB OTG1"
    select DRIVER_USB_DEVICE
    select DRIVER_USB_PB_CLS
    select DRIVER_IMX_USB2_PHY
    select DRIVER_IMX_CI_UDC
    help
        The first ChipIdea controller with its PHY, the SCFW's SC_R_USB_0:
        the i.MX8QXP's USB 2.0 OTG port, the i.MX8DXL's USB OTG1. No board
        in the tree uses it.

config IMX8X_CM_USB_OTG2
    bool "USB OTG2 (i.MX8DXL)"
    depends on PLAT_IMX8XL
    select DRIVER_USB_DEVICE
    select DRIVER_USB_PB_CLS
    select DRIVER_IMX_USB2_PHY
    select DRIVER_IMX_CI_UDC
    help
        The second ChipIdea controller with its PHY, the SCFW's SC_R_USB_1.
endchoice
```
