## configs/jiffy_defconfig
```kconfig
#
# Architecture
#
# CONFIG_ARCH_ARMV8 is not set
CONFIG_ARCH_ARMV7=y
# CONFIG_ARCH_ARMV7M is not set
# CONFIG_ARCH_HOST is not set
# end of Architecture

#
# Platform support
#
CONFIG_SOC_FAMILY_IMX=y
CONFIG_PLAT_CRYPTO_ENGINE=y
CONFIG_PLAT_IMX6UL=y

#
# Output image
#
CONFIG_IMX6UL_CREATE_IMX_IMAGE=y
CONFIG_IMX6UL_SIGN_IMAGE=y
CONFIG_IMX6UL_SRK_TABLE="pki/imx6ul_hab_testkeys/SRK_1_2_3_4_table.bin"
CONFIG_IMX6UL_KEY_INDEX=0
CONFIG_IMX6UL_SIGN_CERT="pki/imx6ul_hab_testkeys/CSF1_1_sha256_4096_65537_v3_usr_crt.pem"
CONFIG_IMX6UL_IMAGE_SIGN_CERT="pki/imx6ul_hab_testkeys/IMG1_1_sha256_4096_65537_v3_usr_crt.pem"
# end of Output image
# end of Platform support

#
# Boot
#

#
# Boot source policy: the board's data names the one it uses
#
# CONFIG_BOOT_POLICY_FIXED is not set
# CONFIG_BOOT_POLICY_CHAIN is not set
CONFIG_BOOT_POLICY_AB=y
# CONFIG_BOOT_AB_SPECULATIVE is not set

#
# Handover: what the next stage gets
#
CONFIG_BOOT_DTB=y
CONFIG_BOOT_LINUX=y
# CONFIG_BOOT_FH is not set
CONFIG_BOOT_DTB_HEADROOM=4096

#
# Loading
#
CONFIG_BOOT_LOAD_CHUNK_kB=1024
# end of Boot

#
# Command mode
#
CONFIG_CM=y
CONFIG_CM_ON_SERIAL_DOWNLOAD=y
CONFIG_CM_BUF_SIZE_KiB=4096
CONFIG_CM_TRANSPORT_READY_TIMEOUT=10
CONFIG_CM_TRANSFER_TIMEOUT=10
CONFIG_CM_AUTH=y
CONFIG_CM_AUTH_TOKEN=y
# CONFIG_CM_AUTH_PASSWORD is not set
CONFIG_IMX6UL_CM_USB_OTG1=y
# end of Command mode

#
# Keys and life cycle
#
CONFIG_SRK_FUSE="pki/imx6ul_hab_testkeys/SRK_1_2_3_4_fuse.bin"
# CONFIG_SLC_EOL is not set
# end of Keys and life cycle

#
# Logging
#
CONFIG_LOGLEVEL=1
CONFIG_PRINT_BOOT_BANNER=y
CONFIG_RAMLOG=y
CONFIG_RAMLOG_SIZE_KiB=16
CONFIG_BOOT_LINUX_RAMOOPS=y
CONFIG_BOOT_LINUX_RAMOOPS_ADDR=0xbff00000
CONFIG_BOOT_LINUX_RAMOOPS_SIZE=0x100000
CONFIG_BOOT_LINUX_RAMOOPS_RECORD_SIZE=0x20000
CONFIG_BOOT_LINUX_RAMOOPS_CONSOLE_SIZE=0x0
CONFIG_BOOT_LINUX_RAMOOPS_FTRACE_SIZE=0x0
CONFIG_BOOT_LINUX_RAMOOPS_PMSG_SIZE=0x0
# end of Logging

#
# Core
#

#
# Watchdog
#
CONFIG_ENABLE_WATCHDOG=y
CONFIG_WATCHDOG_TIMEOUT=5

#
# Limits
#
CONFIG_CRYPTO_MAX_HASH_OPS=1
CONFIG_CRYPTO_MAX_DSA_OPS=1
CONFIG_BIO_MAX_DEVS=32
CONFIG_BIO_MAX_BLOCK_SIZE=4096
# end of Core

#
# Drivers
#
CONFIG_HAVE_IMX_CAAM=y

#
# Crypto
#
CONFIG_DRIVERS_IMX_CAAM=y
# CONFIG_DRIVERS_CRYPTO_MBEDTLS is not set
# end of Crypto

CONFIG_HAVE_IMX_OCOTP=y

#
# Fuses
#
# CONFIG_DRIVERS_FUSE_TEST is not set
CONFIG_DRIVERS_FUSE_IMX_OCOTP=y
# CONFIG_IMX_OCOTP_DEBUG is not set
# end of Fuses

#
# GPIO
#
CONFIG_DRIVERS_IMX_GPIO=y
# end of GPIO

#
# Memory controllers
#
# CONFIG_IMX_FLEXSPI is not set
# end of Memory controllers

#
# MMC and SD
#
CONFIG_MMC_CORE=y
CONFIG_MMC_CORE_MAX_DEVICES=1
# CONFIG_MMC_CORE_DEBUG_CMDS is not set
# CONFIG_MMC_CORE_DEBUG_IOS is not set
# CONFIG_MMC_CORE_HS200_TUNE is not set
# CONFIG_MMC_CORE_OVERRIDE_BOOT_PART_SZ is not set
CONFIG_IMX_USDHC=y
CONFIG_IMX_USDHC_MAX_INSTANCES=1
# end of MMC and SD

#
# Partition tables
#
CONFIG_PARTITION_GPT=y
# CONFIG_PARTITION_STATIC is not set
# end of Partition tables

CONFIG_DRIVERS_IMX_ROM_LOG=y
CONFIG_DRIVERS_IMX_HAB_LOG=y

#
# Timers
#
CONFIG_DRIVERS_IMX_GPT=y
# end of Timers

CONFIG_DRIVERS_TZC380=y
CONFIG_HAVE_IMX_UART=y

#
# UART
#
CONFIG_DRIVERS_IMX_UART=y
# end of UART

CONFIG_HAVE_IMX_CI_UDC=y

#
# USB
#
CONFIG_DRIVER_USB_DEVICE=y
CONFIG_DRIVER_USB_PB_CLS=y
CONFIG_DRIVER_IMX_USB2_PHY=y
CONFIG_DRIVER_IMX_CI_UDC=y
# CONFIG_DRIVER_IMX_USBDCD is not set
# end of USB

#
# Virtio
#
# CONFIG_DRIVER_VIRTIO_BLOCK is not set
# CONFIG_DRIVER_VIRTIO_SERIAL is not set
# end of Virtio

CONFIG_HAVE_IMX_WDOG=y

#
# Watchdog
#
CONFIG_DRIVERS_IMX_WDOG=y
CONFIG_DRIVERS_IMX_WDOG_DEBUG=y
# CONFIG_DRIVERS_IMX_WDOG_WAIT is not set
# end of Watchdog
# end of Drivers

#
# Library
#
CONFIG_LIB_DER_HELPERS=y
CONFIG_LIB_FDT=y
CONFIG_LIB_XLAT_TBLS=y
CONFIG_LIB_XLAT_TBLS_ARMV7=y
# end of Library

#
# Build
#
CONFIG_OPTIMIZE="2"
# CONFIG_DEBUG_SYMBOLS is not set
CONFIG_STACK_SIZE_KiB=16
CONFIG_LINK_FILE="src/link.lds"
# end of Build
```

## src/Kconfig
```kconfig
mainmenu "Punchboot configuration"

menu "Architecture"
source "src/arch/Kconfig"
source "src/arch/*/Kconfig"
endmenu

source "src/plat/Kconfig"

# The board being built (BOARD, see the Makefile), if it has options
osource "$(BOARD)/Kconfig"

menu "Boot"
source "src/boot/Kconfig"
endmenu

menu "Command mode"
source "src/cm/Kconfig"
# The platform's choice of the USB port (platform.md 3.10)
osource "src/plat/*/Kconfig.cm"
endmenu

menu "Keys and life cycle"

# The keys pb verifies images and command mode's tokens with are the board's
# makefile.mk's, VERIFY_KEY<n>_PATH (board.md 7, D-083)

config SRK_FUSE
    string "SRK hash fuse words"
    default ""
    help
        srktool's fuse file (e.g. SRK_1_2_3_4_fuse.bin) of the keys pb is
        signed with, for a board that fuses the SRK hash in
        slc_set_configuration() (include/pb/srk_fuse.h).

config SLC_EOL
    bool "End of life (EOL) as a life cycle state the device can enter"
    depends on CM
    help
        The product's choice (system.md 4). On: SLC_SET_EOL moves the device
        to the SoC's end of life state through the port's set_eol, where the
        port has one. It can't be undone, and command mode is open again in
        that state (D-011).

        Off, the default: the device can't enter EOL. SLC_SET_EOL answers
        NOT_SUPPORTED and slc_set_eol() calls nothing of the port's
        (command-mode.md 4.5, 5.2). A device that is in EOL already still
        reads as that.

endmenu

menu "Logging"

config LOGLEVEL
    int "Console log level"
    default 0
    help
        What the console (UART) prints: 0 nothing, 1 errors, 2 also
        warnings and info, 3 also debug. With CONFIG_RAMLOG the RAM log has
        every level, up to debug (include/pb/log_def.h).

config PRINT_BOOT_BANNER
    bool "Boot banner"
    default y
    help
        pb's version and the boot reason on the console when it is set up.

config RAMLOG
    bool "Enable ram log"
    help
        Everything written to the console is also kept in a ring buffer in
        RAM, the symbol 'ramlog' in the .ramlog section (not zeroed, in the
        RAM pb runs from). It can be read without a UART: over JTAG,
        through a boot ROM USB loader (FEL) or from a RAM dump. The layout
        is struct pb_ramlog_hdr in include/pb/ramlog.h.

        It has every level, up to debug, also the ones above LOGLEVEL,
        which the console doesn't print: the UART can stay quiet and fast
        while the RAM log has the whole story. Those messages are compiled
        in, so pb is larger (debug adds about 8 KiB over info on jiffy).

        Output from before console_init() (early debug prints) goes only
        to the RAM log, and is written to the UART when console_init()
        sets it up. If there was more early output than the log holds,
        only the newest RAMLOG_SIZE_KiB is written out.

config RAMLOG_SIZE_KiB
    int "RAM log size (KiB)"
    default 16
    depends on RAMLOG

menuconfig BOOT_LINUX_RAMOOPS
    bool "Linux's ramoops records as the log 'linux'"
    help
        Linux's pstore/ramoops saves the kernel log in a reserved RAM region
        that survives a warm reset: a dmesg record at an oops or a panic,
        and at a reboot with max-reason = <4> in its device tree node. With
        this, 'punchboot log linux' reads the newest record, with its
        "====<sec>.<usec>-D" header (the time Linux saved it), e.g. after a
        panic and a watchdog reset into command mode. Records must not be
        compressed (CONFIG_PSTORE_COMPRESS off in Linux). pb only reads the
        region, before anything is loaded into it, and the values must
        match the ramoops node in the device tree (reserved-memory,
        ecc-size 0). A cold reset (power, or a PMIC that power cycles the
        DRAM) loses it. The log is only read through command mode, so
        command mode sets it up, not the boot.

config BOOT_LINUX_RAMOOPS_ADDR
    hex "Region address (reg)"
    depends on BOOT_LINUX_RAMOOPS

config BOOT_LINUX_RAMOOPS_SIZE
    hex "Region size (reg)"
    depends on BOOT_LINUX_RAMOOPS

config BOOT_LINUX_RAMOOPS_RECORD_SIZE
    hex "record-size"
    depends on BOOT_LINUX_RAMOOPS

config BOOT_LINUX_RAMOOPS_CONSOLE_SIZE
    hex "console-size"
    depends on BOOT_LINUX_RAMOOPS
    default 0x0

config BOOT_LINUX_RAMOOPS_FTRACE_SIZE
    hex "ftrace-size"
    depends on BOOT_LINUX_RAMOOPS
    default 0x0

config BOOT_LINUX_RAMOOPS_PMSG_SIZE
    hex "pmsg-size"
    depends on BOOT_LINUX_RAMOOPS
    default 0x0

endmenu

menu "Core"

comment "Watchdog"

config ENABLE_WATCHDOG
    bool "Watchdog"
    default y
    help
        The platform arms the SoC's watchdog in plat_early_init(), and pb
        kicks it while it works. Speculative mode needs it.

config WATCHDOG_TIMEOUT
    int "Timeout (s)"
    default 5
    range 1 127
    depends on ENABLE_WATCHDOG
    help
        What every platform's watchdog takes as it is (F-416). The i.MX
        WDOG (6UL, 8M, RT) counts half seconds in eight bits: n s is
        n + 0.5 s, and a longer one was clamped to 128 s, 0 to 0.5 s. The
        8X's SCFW takes milliseconds; Linux's driver for it stops at
        128 s. Kconfig keeps a value outside the range from a defconfig
        out with a warning, so tests/unit/check_watchdog_kconfig.py
        checks every configs/*_defconfig against it.

comment "Limits"

config CRYPTO_MAX_HASH_OPS
    int "Hash backends, at most"
    default 1
    help
        How many hash implementations can be registered (pb/crypto.h).

config CRYPTO_MAX_DSA_OPS
    int "Signature (DSA) backends, at most"
    default 1
    help
        How many signature verification implementations can be
        registered (pb/crypto.h).

config BIO_MAX_DEVS
    int "Block devices, at most"
    default 32

config BIO_MAX_BLOCK_SIZE
    int "Largest block size (bytes)"
    default 4096
    help
        A block device with larger blocks is refused when it is registered
        (bio.md 2.3).

endmenu

menu "Drivers"
source "src/drivers/*/Kconfig"
endmenu

source "src/lib/Kconfig"

menu "Build"

config OPTIMIZE
    string "Optimization level"
    help
        What follows -O: 0, 1, 2, 3, s, z or g.

config DEBUG_SYMBOLS
    bool "Debug symbols (-g)"

config STACK_SIZE_KiB
    int "Stack size (KiB)"
    default 2

config LINK_FILE
    string "Link script"
    default "src/link.lds"
    help
        pb's sections. The platform's link script, with the memory, comes
        before it (platform.md 5.1).

endmenu
```

## src/arch/Kconfig
```kconfig
choice ARCH
    bool "Architecture"
config ARCH_ARMV8
    bool "ARMv8-A (AArch64)"
config ARCH_ARMV7
    bool "ARMv7-A"
config ARCH_ARMV7M
    bool "ARMv7-M"
config ARCH_HOST
    bool "Host (native build, for testing)"
endchoice

choice ARMV8_EL
    bool "Exception level pb runs in"
    depends on ARCH_ARMV8
    help
        EL3, the one level pb supports on ARMv8-A.
config ARMV8_EL3
    bool "EL3"
endchoice
```

## src/arch/armv8a/Kconfig
```kconfig
config ARMV8_RESET_ON_EXCEPTION
    bool "Reset after an unhandled exception"
    depends on ARCH_ARMV8
    help
        After printing an unhandled exception, call plat_reset() instead
        of hanging. Without it, only the watchdog or a debugger ends the
        hang.
```

## src/board/imxrt1060evk/Kconfig
```kconfig
config IMXRT_FLASH
    bool "Run from flash"

choice
    prompt "i.MX RT1060 EVK revision"
    default BOARD_IMXRT1060EVK_REV_A
    help
        The revision picks the FlexSPI configuration block (fcb_*.c) that
        the build puts in front of pb.imx in pb_flash.bin, for the QSPI NOR
        the revision has.

config BOARD_IMXRT1060EVK_REV_A
    bool "MIMXRT1060-EVK (rev A, A1, A2): IS25WP064"

config BOARD_IMXRT1060EVK_REV_B
    bool "MIMXRT1060-EVKB: IS25WP064"

config BOARD_IMXRT1060EVK_REV_C
    bool "MIMXRT1060-EVKC: W25Q128JW"

endchoice
```
