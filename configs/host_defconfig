## src/boot/Kconfig
```kconfig
comment "Boot source policies: the board's data names the one it uses"

config BOOT_POLICY_FIXED
    bool "Fixed: one partition"
    help
        The board gives one partition (BOOT_POLICY_FIXED(), boot/policy_fixed.h).
        No state, nothing to activate.

config BOOT_POLICY_CHAIN
    bool "Staggered chain: a list of partitions"
    help
        The board gives a list of partitions, tried in its order
        (BOOT_POLICY_CHAIN(), boot/policy_chain.h). No state. It protects
        against an image that doesn't load or verify, not against one that
        verifies and then fails.

config BOOT_POLICY_AB
    bool "A/B: two slots, with rollback"
    help
        Two slots and a state in two partitions, a primary and a backup
        (BOOT_POLICY_AB(), boot/ab_state.h). An update is booted on trial
        and rolled back when the OS doesn't confirm it. The OS's side is
        pbstate.

config BOOT_AB_DRIVER
    bool "A/B boot driver (the name of BOOT_POLICY_AB before 3.0.0)"
    select BOOT_POLICY_AB
    help
        Kept so that a configuration from before 3.0.0 builds unchanged.
        Use BOOT_POLICY_AB.

config BOOT_AB_SPECULATIVE
    bool "A/B: speculative mode"
    depends on BOOT_POLICY_AB && ENABLE_WATCHDOG
    default n
    help
        For a system that must stay reachable for an update when no slot
        is viable (boot.md 3.6). Where A/B would enter command mode, it
        boots a slot the OS hasn't confirmed: when the enabled slot is a
        trial without attempts left and the other one isn't confirmed,
        when nothing is enabled (A first), and when this boot's
        candidates failed to load or verify. It alternates the slots per
        boot, counts no attempts, and ends when the OS confirms a slot
        (pbstate). The policy reports such a boot's mode as speculative,
        and the handover passes the mode on to the next stage (boot.md
        5.6).

        It never boots an image that fails verification. With it,
        disabling both slots doesn't park a device in command mode, and
        a device in the factory boots an image that was written and not
        yet activated.

        This is the only switch: the board's data has none. It needs the
        watchdog: the alternation is written before the load, so that a
        hang and the watchdog's reset lead to the other slot.

config BOOT_DTB
    bool
    select LIB_FDT
    help
        The device tree helpers of the handovers (boot/dtb.h). Selected
        by the handovers that pass a device tree on.

config BOOT_LINUX
    bool "Handover: image (Linux, Xen)"
    select BOOT_DTB
    help
        The image handover (boot/image.h, BOOT_HANDOVER_IMAGE()): the Linux
        boot protocol, which Xen follows too. The next stage gets a device
        tree with pb's /chosen. A board delivers it directly, or through
        TF-A (BOOT_ATF).

config BOOT_ATF
    bool "Delivery: TF-A"
    depends on ARCH_ARMV8
    help
        The delivery through TF-A (boot/atf.h, BOOT_DELIVERY_TFA()): pb
        starts BL31 with a bl_params list, in which BL33 is the board's
        handover and BL32 (optional) gets OP-TEE's arguments.

        The delivery alone: it selects no handover and no device tree
        code. A board names it next to its handover and enables that
        too, e.g. the image handover (BOOT_LINUX). Before 3.0.0 this
        option was the whole TF-A boot driver.

        ARMv8-A only.

config BOOT_DTB_HEADROOM
    int "Device tree headroom (bytes)"
    depends on BOOT_DTB
    default 4096
    help
        The image handover adds /chosen and pb's properties to the
        device tree: pb,device-uuid, pb,slc, pb,slc-active-key,
        pb,slc-available-keys, pb,active-system, the initrd and what the
        board's callback sets (bootargs). First they grow the device tree in
        place by this many bytes, into the RAM after its part. Leave that RAM
        free in the boot image: another part or pb there fails the boot.
        For a device tree in dtc's block order growing only changes its
        size in the header. A device tree built with the properties and free
        space for them (dtc -p) doesn't need it, set 0 then.

config BOOT_SIMPLE
    bool "Simple boot protocol (include/boot/simple.h)"

config BOOT_LOAD_CHUNK_kB
    int "Copy/Hash load chunk size (kB)"
    range 1 1048576
    default 4096

config BOOT_LINUX_RAMOOPS
    bool "Read Linux's ramoops records as the log 'linux'"
    help
        Linux's pstore/ramoops saves the kernel log in a reserved RAM region
        that survives a warm reset: a dmesg record at an oops or a panic,
        and at a reboot with max-reason = <4> in its device tree node. With
        this, 'punchboot log linux' reads the newest record, with its
        "====<sec>.<usec>-D" header (the time Linux saved it), e.g. after a
        panic and a watchdog reset into command mode. Records must not be
        compressed (CONFIG_PSTORE_COMPRESS off in Linux). pb only reads the
        region, before anything is loaded into it, and the values must
        match the ramoops node in the device tree (reserved-memory,
        ecc-size 0). A cold reset (power, or a PMIC that power cycles the
        DRAM) loses it. The log is only read through command mode, so
        command mode sets it up, not the boot.

config BOOT_LINUX_RAMOOPS_ADDR
    hex "ramoops region address"
    depends on BOOT_LINUX_RAMOOPS

config BOOT_LINUX_RAMOOPS_SIZE
    hex "ramoops region size"
    depends on BOOT_LINUX_RAMOOPS

config BOOT_LINUX_RAMOOPS_RECORD_SIZE
    hex "ramoops record-size"
    depends on BOOT_LINUX_RAMOOPS

config BOOT_LINUX_RAMOOPS_CONSOLE_SIZE
    hex "ramoops console-size"
    depends on BOOT_LINUX_RAMOOPS
    default 0x0

config BOOT_LINUX_RAMOOPS_FTRACE_SIZE
    hex "ramoops ftrace-size"
    depends on BOOT_LINUX_RAMOOPS
    default 0x0

config BOOT_LINUX_RAMOOPS_PMSG_SIZE
    hex "ramoops pmsg-size"
    depends on BOOT_LINUX_RAMOOPS
    default 0x0
```

## src/cm/Kconfig
```kconfig
config CM
    bool "Command mode"
    default y
    help
        pb's USB interface to a host: the punchboot tool's commands
        (command-mode.md). Off: pb only boots.

config CM_ON_SERIAL_DOWNLOAD
    bool "Stop in command mode after a serial download"
    default y
    depends on CM
    help
        When the ROM's serial downloader loaded pb, over USB or a UART
        (plat_get_boot_source()), the boot stops before anything else and pb
        enters command mode: the host that loaded pb is at the other end
        (board.md 5.1). A boot that command mode starts isn't stopped.

        Off: pb boots from storage after a serial download too. A platform
        that can't tell how pb was loaded never stops for it, whatever this
        is.

config CM_BUF_SIZE_KiB
    int "Command buffer size (KiB)"
    default 4096
    depends on CM
    help
        The buffer the data of a command goes through, a partition write
        or an image to boot, in pb's buffers (PB_BUFFERS_SIZE holds it).
        The host reads its size from the caps and sends its data in chunks
        of it; the USB controller's transfer descriptors are sized by it.

config CM_TRANSPORT_READY_TIMEOUT
    int "Wait for a host (s)"
    default 10
    range 1 4294
    depends on CM
    help
        How long command mode waits for a host while it has no session.
        Then pb resets (command-mode.md 2.2). pb's timeouts count
        microseconds in 32 bits, hence at most 4294 s. A value outside the
        range isn't used: the build takes the default.

config CM_TRANSFER_TIMEOUT
    int "Transfer timeout (s)"
    default 10
    range 1 65
    depends on CM
    help
        How long command mode waits for the host to complete a transfer
        inside a command, kicking the watchdog meanwhile. Then the session
        ends and the transport is restarted (command-mode.md 4.6). The caps
        carry it in milliseconds, in 16 bits, hence at most 65 s.

config CM_AUTH
    bool "Authentication (the gate)"
    default y
    depends on CM
    help
        Command mode's gate (command-mode.md 3.2). On: a closed device (a
        locked or an unknown life cycle) answers only DEVICE_IDENTIFIER_READ
        and AUTHENTICATE until the session authenticates, and the build
        selects at least one method below, or it doesn't build.

        Off: no gate. Every session counts as authenticated, so command
        mode is open in every life cycle state, also on a locked device.
        That is the product's choice, made in its defconfig (D-059).

config CM_AUTH_TOKEN
    bool "Token"
    depends on CM_AUTH
    help
        The host sends a signature over the device's UUID, made with a key
        of the keystore (command-mode.md 3.3).

config CM_AUTH_PASSWORD
    bool "Password"
    depends on CM_AUTH
    help
        The host sends a password, which the board checks (its
        password_auth(), board.md 4.4).
```

## src/drivers/crypto/Kconfig
```kconfig
# Selected by the platforms whose SoC has it (platform.md 6.1)
config HAVE_IMX_CAAM
    bool

menu "Crypto"

config DRIVERS_IMX_CAAM
    bool "i.MX CAAM"
    depends on HAVE_IMX_CAAM
    default y
    select LIB_DER_HELPERS
    help
        The i.MX crypto engine: hashes, signature verification and the
        RNG, set up in plat_init() (crypto.md).

menuconfig DRIVERS_CRYPTO_MBEDTLS
    bool "Mbed TLS (software)"

if DRIVERS_CRYPTO_MBEDTLS
source "src/drivers/crypto/mbedtls/Kconfig"
endif

endmenu
```

## src/drivers/fuse/Kconfig
```kconfig
# Selected by the platforms whose SoC has it (platform.md 6.1)
config HAVE_IMX_OCOTP
    bool

menu "Fuses"

config DRIVERS_FUSE_TEST
    bool "Test fuse box on a block device"
    help
        A fuse box kept in a block device, for the host build's tests.

config DRIVERS_FUSE_IMX_OCOTP
    bool "i.MX OCOTP"
    depends on HAVE_IMX_OCOTP

config IMX_OCOTP_DEBUG
    bool "Debug output"
    depends on DRIVERS_FUSE_IMX_OCOTP

endmenu
```

## src/drivers/memc/Kconfig
```kconfig
menu "Memory controllers"

config IMX_FLEXSPI
    bool "i.MX FlexSPI NOR"
    depends on SOC_FAMILY_IMX

endmenu
```

## src/drivers/mmc/Kconfig
```kconfig
menu "MMC and SD"

config MMC_CORE
    bool "MMC core (e.MMC, SD)"

config MMC_CORE_MAX_DEVICES
    int "Cards"
    depends on MMC_CORE
    default 1
    help
        How many cards (e.MMC, SD) the board initializes.

config MMC_CORE_DEBUG_CMDS
    bool "Debug: log the commands"
    depends on MMC_CORE

config MMC_CORE_DEBUG_IOS
    bool "Debug: log the reads and writes"
    depends on MMC_CORE

config MMC_CORE_HS200_TUNE
    bool "HS200 tuning"
    depends on MMC_CORE
    help
        Pick the delay tap in HS200 with CMD21 tuning blocks instead of
        using the board's: every tap is tried and the middle of the widest
        working window is used. One CMD21 per tap, about 2 ms for 128 taps
        at 200 MHz. If no tap works the card runs in high speed (52 MHz)
        with the board's tap, so a marginal board still boots.

config MMC_CORE_OVERRIDE_BOOT_PART_SZ
    bool "Override the boot partitions' size"
    depends on MMC_CORE
    help
        Most products leave this off. Use the size below instead of the
        one the card's EXT_CSD reports for its boot partitions.

config MMC_CORE_BOOT_PART_SZ_KiB
    int "Boot partition size (KiB)"
    depends on MMC_CORE_OVERRIDE_BOOT_PART_SZ
    default 0

config IMX_USDHC
    bool "i.MX uSDHC"
    depends on SOC_FAMILY_IMX
    select MMC_CORE

config IMX_USDHC_MAX_INSTANCES
    int "uSDHC controllers"
    depends on IMX_USDHC
    default 1
    help
        How many uSDHC controllers the board uses. Each has a 4 KiB ADMA2
        descriptor table.

endmenu
```

## src/drivers/partition/Kconfig
```kconfig
menu "Partition tables"

config PARTITION_GPT
    bool "GPT"

config PARTITION_STATIC
    bool "Static table"

endmenu
```

## src/drivers/timer/Kconfig
```kconfig
menu "Timers"

config DRIVERS_IMX_GPT
    bool "i.MX GPT"
    depends on SOC_FAMILY_IMX
    default y

endmenu
```

## src/drivers/virtio/Kconfig
```kconfig
menu "Virtio"

config DRIVER_VIRTIO_BLOCK
    bool "Virtio block device"

config DRIVER_VIRTIO_SERIAL
    bool "Virtio serial device"

endmenu
```

## src/drivers/wdog/Kconfig
```kconfig
# Selected by the platforms whose SoC has it (platform.md 6.1)
config HAVE_IMX_WDOG
    bool

menu "Watchdog"

config DRIVERS_IMX_WDOG
    bool "i.MX WDOG"
    depends on HAVE_IMX_WDOG

config DRIVERS_IMX_WDOG_DEBUG
    bool "Paused while the core is halted (debug)"
    depends on DRIVERS_IMX_WDOG
    help
        WDOG_WCR's WDBG: the watchdog doesn't count while a debugger
        halts the core.

config DRIVERS_IMX_WDOG_WAIT
    bool "Paused in wait mode"
    depends on DRIVERS_IMX_WDOG
    help
        WDOG_WCR's WDW: the watchdog doesn't count in the low power wait
        mode.

endmenu
```
