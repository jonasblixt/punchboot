## configs/host_defconfig
```kconfig
# Native host build used by the unit and integration tests (CMakeLists.txt).
CONFIG_ARCH_HOST=y
CONFIG_PLAT_HOST=y
CONFIG_KEYSTORE="pki/internal_keystore.bpak"
CONFIG_LOGLEVEL=3
# CONFIG_ENABLE_WATCHDOG is not set
CONFIG_PRINT_BOOT_BANNER=y
CONFIG_DEVICE_UUID=y
CONFIG_CRYPTO=y
CONFIG_BIO_CORE=y
CONFIG_BIO_MAX_DEVS=32
# CONFIG_SELF_TEST is not set
CONFIG_BOOT_CORE=y
CONFIG_BOOT_BPAK_IMAGE_HELPERS=y
CONFIG_BOOT_AB_DRIVER=y
CONFIG_BOOT_LINUX=y
CONFIG_BOOT_LOAD_CHUNK_kB=4096
CONFIG_DRIVERS_CRYPTO_MBEDTLS=y
CONFIG_MBEDTLS_MD_SHA256=y
CONFIG_MBEDTLS_MD_SHA384=y
CONFIG_MBEDTLS_MD_SHA512=y
CONFIG_MBEDTLS_MD_MD5=y
CONFIG_MBEDTLS_ECDSA=y
CONFIG_MBEDTLS_STRERROR=y
CONFIG_DRIVERS_FUSE_TEST=y
CONFIG_PARTITION_GPT=y
# CONFIG_DRIVER_VIRTIO_BLOCK is not set
# CONFIG_DRIVER_VIRTIO_SERIAL is not set
# CONFIG_DRIVER_USB_DEVICE is not set
CONFIG_CM=y
CONFIG_CM_BUF_SIZE_KiB=4
CONFIG_CM_TRANSPORT_READY_TIMEOUT=10
CONFIG_CM_AUTH=y
CONFIG_CM_AUTH_TOKEN=y
CONFIG_CM_AUTH_PASSWORD=y
CONFIG_LIB_ZLIB_CRC=y
CONFIG_LIB_BPAK=y
CONFIG_LIB_DER_HELPERS=y
CONFIG_LIB_FDT=y
CONFIG_LIB_UUID=y
CONFIG_LIB_UUID3=y
# CONFIG_LIB_XLAT_TBLS is not set
```

## configs/imx8dxlevk_defconfig
```kconfig
#
# Architecture
#
CONFIG_ARCH_ARMV8=y
# CONFIG_ARCH_ARMV7 is not set
# CONFIG_ARCH_ARMV7M is not set
# CONFIG_ARCH_HOST is not set
CONFIG_ARMV8_EL3=y
# CONFIG_ARMV8_RESET_ON_EXCEPTION is not set
# end of Architecture

#
# Platform support
#
CONFIG_SOC_FAMILY_IMX=y
CONFIG_PLAT_CRYPTO_ENGINE=y
CONFIG_PLAT_IMX8X_COMMON=y
# CONFIG_PLAT_IMX8X is not set
CONFIG_PLAT_IMX8XL=y
# CONFIG_PLAT_IMX8MQ is not set
# CONFIG_PLAT_IMX8MP is not set

#
# i.MX8X options
#
# CONFIG_IMX8X_FUSE_DRY_RUN is not set
# end of i.MX8X options

#
# Output image
#
CONFIG_IMX8X_CREATE_IMX_IMAGE=y
# CONFIG_IMX8X_SIGN_IMAGE is not set
# end of Output image
# end of Platform support

#
# Boot
#

#
# Boot source policy: the board's data names the one it uses
#
# CONFIG_BOOT_POLICY_FIXED is not set
# CONFIG_BOOT_POLICY_CHAIN is not set
CONFIG_BOOT_POLICY_AB=y
# CONFIG_BOOT_AB_SPECULATIVE is not set

#
# Handover: what the next stage gets
#
CONFIG_BOOT_DTB=y
CONFIG_BOOT_LINUX=y
# CONFIG_BOOT_FH is not set
CONFIG_BOOT_DTB_HEADROOM=4096

#
# Delivery: how pb starts the next stage
#
CONFIG_BOOT_ATF=y

#
# Loading
#
CONFIG_BOOT_LOAD_CHUNK_kB=4096
# end of Boot

#
# Command mode
#
CONFIG_CM=y
CONFIG_CM_ON_SERIAL_DOWNLOAD=y
CONFIG_CM_BUF_SIZE_KiB=4096
CONFIG_CM_TRANSPORT_READY_TIMEOUT=10
CONFIG_CM_TRANSFER_TIMEOUT=10
CONFIG_CM_AUTH=y
CONFIG_CM_AUTH_TOKEN=y
CONFIG_CM_AUTH_PASSWORD=y
CONFIG_IMX8X_CM_USB_OTG2=y
# end of Command mode

#
# Keys and life cycle
#
CONFIG_SRK_FUSE="pki/imx8x_ahab/crts/SRK_1_2_3_4_fuse.bin"
# CONFIG_SLC_EOL is not set
# end of Keys and life cycle

#
# Logging
#
CONFIG_LOGLEVEL=3
CONFIG_PRINT_BOOT_BANNER=y
# CONFIG_RAMLOG is not set
# CONFIG_BOOT_LINUX_RAMOOPS is not set
# end of Logging

#
# Core
#

#
# Watchdog
#
CONFIG_ENABLE_WATCHDOG=y
CONFIG_WATCHDOG_TIMEOUT=10

#
# Limits
#
CONFIG_CRYPTO_MAX_HASH_OPS=1
CONFIG_CRYPTO_MAX_DSA_OPS=1
CONFIG_BIO_MAX_DEVS=128
CONFIG_BIO_MAX_BLOCK_SIZE=4096
# end of Core

#
# Drivers
#
CONFIG_HAVE_IMX_CAAM=y

#
# Crypto
#
CONFIG_DRIVERS_IMX_CAAM=y
# CONFIG_DRIVERS_CRYPTO_MBEDTLS is not set
# end of Crypto

#
# Fuses
#
# CONFIG_DRIVERS_FUSE_TEST is not set
# end of Fuses

#
# GPIO
#
CONFIG_DRIVERS_IMX_GPIO=y
# end of GPIO

#
# Memory controllers
#
# CONFIG_IMX_FLEXSPI is not set
# end of Memory controllers

#
# MMC and SD
#
CONFIG_MMC_CORE=y
CONFIG_MMC_CORE_MAX_DEVICES=1
# CONFIG_MMC_CORE_DEBUG_CMDS is not set
# CONFIG_MMC_CORE_DEBUG_IOS is not set
# CONFIG_MMC_CORE_HS200_TUNE is not set
# CONFIG_MMC_CORE_OVERRIDE_BOOT_PART_SZ is not set
CONFIG_IMX_USDHC=y
CONFIG_IMX_USDHC_MAX_INSTANCES=1
# end of MMC and SD

#
# Partition tables
#
CONFIG_PARTITION_GPT=y
# CONFIG_PARTITION_STATIC is not set
# end of Partition tables

#
# Timers
#
CONFIG_DRIVERS_IMX_GPT=y
# end of Timers

CONFIG_HAVE_IMX_LPUART=y

#
# UART
#
CONFIG_DRIVERS_IMX_LPUART=y
# end of UART

CONFIG_HAVE_IMX_CI_UDC=y

#
# USB
#
CONFIG_DRIVER_USB_DEVICE=y
CONFIG_DRIVER_USB_PB_CLS=y
CONFIG_DRIVER_IMX_USB2_PHY=y
CONFIG_DRIVER_IMX_CI_UDC=y
CONFIG_DRIVER_IMX_USBDCD=y
# end of USB

#
# Virtio
#
# CONFIG_DRIVER_VIRTIO_BLOCK is not set
# CONFIG_DRIVER_VIRTIO_SERIAL is not set
# end of Virtio

#
# Watchdog
#
# end of Watchdog
# end of Drivers

#
# Library
#
CONFIG_LIB_DER_HELPERS=y
CONFIG_LIB_FDT=y
CONFIG_LIB_XLAT_TBLS=y
CONFIG_LIB_XLAT_TBLS_ARMV8=y
# end of Library

#
# Build
#
CONFIG_OPTIMIZE="2"
# CONFIG_DEBUG_SYMBOLS is not set
CONFIG_STACK_SIZE_KiB=16
CONFIG_LINK_FILE="src/link.lds"
# end of Build
```

## configs/imx8mevk_defconfig
```kconfig
#
# Architecture
#
CONFIG_ARCH_ARMV8=y
# CONFIG_ARCH_ARMV7 is not set
# CONFIG_ARCH_ARMV7M is not set
# CONFIG_ARCH_HOST is not set
CONFIG_ARMV8_EL3=y
# CONFIG_ARMV8_RESET_ON_EXCEPTION is not set
# end of Architecture

#
# Platform support
#
CONFIG_SOC_FAMILY_IMX=y
CONFIG_PLAT_CRYPTO_ENGINE=y
CONFIG_PLAT_IMX8M_COMMON=y
# CONFIG_PLAT_IMX8X is not set
# CONFIG_PLAT_IMX8XL is not set
CONFIG_PLAT_IMX8MQ=y
# CONFIG_PLAT_IMX8MP is not set

#
# Output image
#
CONFIG_IMX8M_CREATE_IMX_IMAGE=y
CONFIG_IMX8M_SIGN_IMAGE=y
CONFIG_IMX8M_SRK_TABLE="pki/imx6ul_hab_testkeys/SRK_1_2_3_4_table.bin"
CONFIG_IMX8M_KEY_INDEX=0
CONFIG_IMX8M_SIGN_CERT="pki/imx6ul_hab_testkeys/CSF1_1_sha256_4096_65537_v3_usr_crt.pem"
CONFIG_IMX8M_IMAGE_SIGN_CERT="pki/imx6ul_hab_testkeys/IMG1_1_sha256_4096_65537_v3_usr_crt.pem"
# end of Output image
# end of Platform support

#
# Boot
#

#
# Boot source policy: the board's data names the one it uses
#
# CONFIG_BOOT_POLICY_FIXED is not set
# CONFIG_BOOT_POLICY_CHAIN is not set
CONFIG_BOOT_POLICY_AB=y
# CONFIG_BOOT_AB_SPECULATIVE is not set

#
# Handover: what the next stage gets
#
CONFIG_BOOT_DTB=y
CONFIG_BOOT_LINUX=y
# CONFIG_BOOT_FH is not set
CONFIG_BOOT_DTB_HEADROOM=4096

#
# Delivery: how pb starts the next stage
#
# CONFIG_BOOT_ATF is not set

#
# Loading
#
CONFIG_BOOT_LOAD_CHUNK_kB=4096
# end of Boot

#
# Command mode
#
CONFIG_CM=y
CONFIG_CM_ON_SERIAL_DOWNLOAD=y
CONFIG_CM_BUF_SIZE_KiB=4096
CONFIG_CM_TRANSPORT_READY_TIMEOUT=10
CONFIG_CM_TRANSFER_TIMEOUT=10
CONFIG_CM_AUTH=y
CONFIG_CM_AUTH_TOKEN=y
# CONFIG_CM_AUTH_PASSWORD is not set
CONFIG_IMX8M_CM_USB1=y
# end of Command mode

#
# Keys and life cycle
#
CONFIG_SRK_FUSE=""
# CONFIG_SLC_EOL is not set
# end of Keys and life cycle

#
# Logging
#
CONFIG_LOGLEVEL=3
CONFIG_PRINT_BOOT_BANNER=y
# CONFIG_RAMLOG is not set
# CONFIG_BOOT_LINUX_RAMOOPS is not set
# end of Logging

#
# Core
#

#
# Watchdog
#
CONFIG_ENABLE_WATCHDOG=y
CONFIG_WATCHDOG_TIMEOUT=5

#
# Limits
#
CONFIG_CRYPTO_MAX_HASH_OPS=8
CONFIG_CRYPTO_MAX_DSA_OPS=8
CONFIG_BIO_MAX_DEVS=64
CONFIG_BIO_MAX_BLOCK_SIZE=4096
# end of Core

#
# Drivers
#
CONFIG_HAVE_IMX_CAAM=y

#
# Crypto
#
CONFIG_DRIVERS_IMX_CAAM=y
# CONFIG_DRIVERS_CRYPTO_MBEDTLS is not set
# end of Crypto

CONFIG_DRIVERS_DDR_UMCTL2=y
CONFIG_DRIVERS_DDR_DWC_PHY=y
CONFIG_HAVE_IMX_OCOTP=y

#
# Fuses
#
# CONFIG_DRIVERS_FUSE_TEST is not set
CONFIG_DRIVERS_FUSE_IMX_OCOTP=y
# CONFIG_IMX_OCOTP_DEBUG is not set
# end of Fuses

#
# GPIO
#
CONFIG_DRIVERS_IMX_GPIO=y
# end of GPIO

#
# Memory controllers
#
# CONFIG_IMX_FLEXSPI is not set
# end of Memory controllers

#
# MMC and SD
#
CONFIG_MMC_CORE=y
CONFIG_MMC_CORE_MAX_DEVICES=1
# CONFIG_MMC_CORE_DEBUG_CMDS is not set
# CONFIG_MMC_CORE_DEBUG_IOS is not set
# CONFIG_MMC_CORE_HS200_TUNE is not set
# CONFIG_MMC_CORE_OVERRIDE_BOOT_PART_SZ is not set
CONFIG_IMX_USDHC=y
CONFIG_IMX_USDHC_MAX_INSTANCES=1
# end of MMC and SD

#
# Partition tables
#
CONFIG_PARTITION_GPT=y
# CONFIG_PARTITION_STATIC is not set
# end of Partition tables

CONFIG_DRIVERS_IMX_ROM_LOG=y
CONFIG_DRIVERS_IMX_HAB_LOG=y

#
# Timers
#
CONFIG_DRIVERS_IMX_GPT=y
# end of Timers

CONFIG_DRIVERS_TZC380=y
CONFIG_HAVE_IMX_UART=y

#
# UART
#
CONFIG_DRIVERS_IMX_UART=y
# end of UART

CONFIG_HAVE_IMX_DWC3_UDC=y

#
# USB
#
CONFIG_DRIVER_USB_DEVICE=y
CONFIG_DRIVER_USB_PB_CLS=y
CONFIG_DRIVER_IMX_DWC3_UDC=y
CONFIG_DRIVER_IMX8M_PHY=y
# end of USB

#
# Virtio
#
# CONFIG_DRIVER_VIRTIO_BLOCK is not set
# CONFIG_DRIVER_VIRTIO_SERIAL is not set
# end of Virtio

CONFIG_HAVE_IMX_WDOG=y

#
# Watchdog
#
CONFIG_DRIVERS_IMX_WDOG=y
# CONFIG_DRIVERS_IMX_WDOG_DEBUG is not set
# CONFIG_DRIVERS_IMX_WDOG_WAIT is not set
# end of Watchdog
# end of Drivers

#
# Library
#
CONFIG_LIB_DER_HELPERS=y
CONFIG_LIB_FDT=y
CONFIG_LIB_XLAT_TBLS=y
CONFIG_LIB_XLAT_TBLS_ARMV8=y
# end of Library

#
# Build
#
CONFIG_OPTIMIZE="2"
# CONFIG_DEBUG_SYMBOLS is not set
CONFIG_STACK_SIZE_KiB=8
CONFIG_LINK_FILE="src/link.lds"
# end of Build
```

## configs/imx8mpevk_defconfig
```kconfig
#
# Architecture
#
CONFIG_ARCH_ARMV8=y
# CONFIG_ARCH_ARMV7 is not set
# CONFIG_ARCH_ARMV7M is not set
# CONFIG_ARCH_HOST is not set
CONFIG_ARMV8_EL3=y
# CONFIG_ARMV8_RESET_ON_EXCEPTION is not set
# end of Architecture

#
# Platform support
#
CONFIG_SOC_FAMILY_IMX=y
CONFIG_PLAT_CRYPTO_ENGINE=y
CONFIG_PLAT_IMX8M_COMMON=y
# CONFIG_PLAT_IMX8X is not set
# CONFIG_PLAT_IMX8XL is not set
# CONFIG_PLAT_IMX8MQ is not set
CONFIG_PLAT_IMX8MP=y

#
# Output image
#
CONFIG_IMX8M_CREATE_IMX_IMAGE=y
# end of Output image
# end of Platform support

#
# Boot
#

#
# Boot source policy: the board's data names the one it uses
#
# CONFIG_BOOT_POLICY_FIXED is not set
# CONFIG_BOOT_POLICY_CHAIN is not set
CONFIG_BOOT_POLICY_AB=y
# CONFIG_BOOT_AB_SPECULATIVE is not set

#
# Handover: what the next stage gets
#
CONFIG_BOOT_DTB=y
CONFIG_BOOT_LINUX=y
# CONFIG_BOOT_FH is not set
CONFIG_BOOT_DTB_HEADROOM=4096

#
# Delivery: how pb starts the next stage
#
CONFIG_BOOT_ATF=y

#
# Loading
#
CONFIG_BOOT_LOAD_CHUNK_kB=1024
# end of Boot

#
# Command mode
#
CONFIG_CM=y
CONFIG_CM_ON_SERIAL_DOWNLOAD=y
CONFIG_CM_BUF_SIZE_KiB=4096
CONFIG_CM_TRANSPORT_READY_TIMEOUT=10
CONFIG_CM_TRANSFER_TIMEOUT=10
CONFIG_CM_AUTH=y
CONFIG_CM_AUTH_TOKEN=y
# CONFIG_CM_AUTH_PASSWORD is not set
CONFIG_IMX8M_CM_USB1=y
# end of Command mode

#
# Keys and life cycle
#
CONFIG_SRK_FUSE=""
# CONFIG_SLC_EOL is not set
# end of Keys and life cycle

#
# Logging
#
CONFIG_LOGLEVEL=1
CONFIG_PRINT_BOOT_BANNER=y
CONFIG_RAMLOG=y
CONFIG_RAMLOG_SIZE_KiB=16
CONFIG_BOOT_LINUX_RAMOOPS=y
CONFIG_BOOT_LINUX_RAMOOPS_ADDR=0xbff00000
CONFIG_BOOT_LINUX_RAMOOPS_SIZE=0x100000
CONFIG_BOOT_LINUX_RAMOOPS_RECORD_SIZE=0x20000
CONFIG_BOOT_LINUX_RAMOOPS_CONSOLE_SIZE=0x0
CONFIG_BOOT_LINUX_RAMOOPS_FTRACE_SIZE=0x0
CONFIG_BOOT_LINUX_RAMOOPS_PMSG_SIZE=0x0
# end of Logging

#
# Core
#

#
# Watchdog
#
CONFIG_ENABLE_WATCHDOG=y
CONFIG_WATCHDOG_TIMEOUT=5

#
# Limits
#
CONFIG_CRYPTO_MAX_HASH_OPS=8
CONFIG_CRYPTO_MAX_DSA_OPS=8
CONFIG_BIO_MAX_DEVS=64
CONFIG_BIO_MAX_BLOCK_SIZE=4096
# end of Core

#
# Drivers
#
CONFIG_HAVE_IMX_CAAM=y

#
# Crypto
#
CONFIG_DRIVERS_IMX_CAAM=y
# CONFIG_DRIVERS_CRYPTO_MBEDTLS is not set
# end of Crypto

CONFIG_DRIVERS_DDR_UMCTL2=y
CONFIG_DRIVERS_DDR_DWC_PHY=y
CONFIG_HAVE_IMX_OCOTP=y

#
# Fuses
#
# CONFIG_DRIVERS_FUSE_TEST is not set
CONFIG_DRIVERS_FUSE_IMX_OCOTP=y
# CONFIG_IMX_OCOTP_DEBUG is not set
# end of Fuses

#
# GPIO
#
CONFIG_DRIVERS_IMX_GPIO=y
# end of GPIO

#
# Memory controllers
#
# CONFIG_IMX_FLEXSPI is not set
# end of Memory controllers

#
# MMC and SD
#
CONFIG_MMC_CORE=y
CONFIG_MMC_CORE_MAX_DEVICES=2
# CONFIG_MMC_CORE_DEBUG_CMDS is not set
# CONFIG_MMC_CORE_DEBUG_IOS is not set
CONFIG_MMC_CORE_HS200_TUNE=y
# CONFIG_MMC_CORE_OVERRIDE_BOOT_PART_SZ is not set
CONFIG_IMX_USDHC=y
CONFIG_IMX_USDHC_MAX_INSTANCES=2
# end of MMC and SD

#
# Partition tables
#
CONFIG_PARTITION_GPT=y
# CONFIG_PARTITION_STATIC is not set
# end of Partition tables

CONFIG_DRIVERS_IMX_ROM_LOG=y
CONFIG_DRIVERS_IMX_HAB_LOG=y

#
# Timers
#
CONFIG_DRIVERS_IMX_GPT=y
# end of Timers

CONFIG_DRIVERS_TZC380=y
CONFIG_HAVE_IMX_UART=y

#
# UART
#
CONFIG_DRIVERS_IMX_UART=y
# end of UART

CONFIG_HAVE_IMX_DWC3_UDC=y

#
# USB
#
CONFIG_DRIVER_USB_DEVICE=y
CONFIG_DRIVER_USB_PB_CLS=y
CONFIG_DRIVER_IMX_DWC3_UDC=y
CONFIG_DRIVER_IMX8M_PHY=y
# end of USB

#
# Virtio
#
# CONFIG_DRIVER_VIRTIO_BLOCK is not set
# CONFIG_DRIVER_VIRTIO_SERIAL is not set
# end of Virtio

CONFIG_HAVE_IMX_WDOG=y

#
# Watchdog
#
CONFIG_DRIVERS_IMX_WDOG=y
# CONFIG_DRIVERS_IMX_WDOG_DEBUG is not set
# CONFIG_DRIVERS_IMX_WDOG_WAIT is not set
# end of Watchdog
# end of Drivers

#
# Library
#
CONFIG_LIB_DER_HELPERS=y
CONFIG_LIB_FDT=y
CONFIG_LIB_XLAT_TBLS=y
CONFIG_LIB_XLAT_TBLS_ARMV8=y
# end of Library

#
# Build
#
CONFIG_OPTIMIZE="2"
# CONFIG_DEBUG_SYMBOLS is not set
CONFIG_STACK_SIZE_KiB=8
CONFIG_LINK_FILE="src/link.lds"
# end of Build
```

## configs/imxrt1060evk_defconfig
```kconfig
#
# Architecture
#
# CONFIG_ARCH_ARMV8 is not set
# CONFIG_ARCH_ARMV7 is not set
CONFIG_ARCH_ARMV7M=y
# CONFIG_ARCH_HOST is not set
# end of Architecture

#
# Platform support
#
CONFIG_SOC_FAMILY_IMX=y
CONFIG_PLAT_CRYPTO_ENGINE=y
CONFIG_PLAT_IMXRT=y

#
# Output image
#
CONFIG_IMXRT_CREATE_IMX_IMAGE=y
CONFIG_IMXRT_CREATE_FLASH_IMAGE=y
# end of Output image
# end of Platform support

CONFIG_BOARD_IMXRT1060EVK_REV_A=y
# CONFIG_BOARD_IMXRT1060EVK_REV_B is not set
# CONFIG_BOARD_IMXRT1060EVK_REV_C is not set

#
# Boot
#

#
# Boot source policy: the board's data names the one it uses
#
# CONFIG_BOOT_POLICY_FIXED is not set
# CONFIG_BOOT_POLICY_CHAIN is not set
CONFIG_BOOT_POLICY_AB=y
# CONFIG_BOOT_AB_SPECULATIVE is not set

#
# Handover: what the next stage gets
#
CONFIG_BOOT_DTB=y
# CONFIG_BOOT_LINUX is not set
CONFIG_BOOT_FH=y
CONFIG_BOOT_FH_REGION_BASE=0x20208000
CONFIG_BOOT_FH_REGION_SIZE=0x1000
CONFIG_BOOT_DTB_HEADROOM=4096

#
# Loading
#
CONFIG_BOOT_LOAD_CHUNK_kB=4
# end of Boot

#
# Command mode
#
CONFIG_CM=y
CONFIG_CM_ON_SERIAL_DOWNLOAD=y
CONFIG_CM_BUF_SIZE_KiB=32
CONFIG_CM_TRANSPORT_READY_TIMEOUT=10
CONFIG_CM_TRANSFER_TIMEOUT=10
CONFIG_CM_AUTH=y
CONFIG_CM_AUTH_TOKEN=y
# CONFIG_CM_AUTH_PASSWORD is not set
CONFIG_IMXRT_CM_USB_OTG1=y
# end of Command mode

#
# Keys and life cycle
#
CONFIG_SRK_FUSE=""
# CONFIG_SLC_EOL is not set
# end of Keys and life cycle

#
# Logging
#
CONFIG_LOGLEVEL=1
CONFIG_PRINT_BOOT_BANNER=y
CONFIG_RAMLOG=y
CONFIG_RAMLOG_SIZE_KiB=16
# CONFIG_BOOT_LINUX_RAMOOPS is not set
# end of Logging

#
# Core
#

#
# Watchdog
#
CONFIG_ENABLE_WATCHDOG=y
CONFIG_WATCHDOG_TIMEOUT=30

#
# Limits
#
CONFIG_CRYPTO_MAX_HASH_OPS=3
CONFIG_CRYPTO_MAX_DSA_OPS=3
CONFIG_BIO_MAX_DEVS=16
CONFIG_BIO_MAX_BLOCK_SIZE=4096
# end of Core

#
# Drivers
#

#
# Crypto
#
CONFIG_DRIVERS_CRYPTO_MBEDTLS=y
CONFIG_MBEDTLS_MD_SHA256=y
# CONFIG_MBEDTLS_MD_SHA384 is not set
# CONFIG_MBEDTLS_MD_SHA512 is not set
CONFIG_MBEDTLS_MD_MD5=y
CONFIG_MBEDTLS_ECDSA=y
# CONFIG_MBEDTLS_STRERROR is not set
# end of Crypto

CONFIG_HAVE_IMX_OCOTP=y

#
# Fuses
#
# CONFIG_DRIVERS_FUSE_TEST is not set
CONFIG_DRIVERS_FUSE_IMX_OCOTP=y
# CONFIG_IMX_OCOTP_DEBUG is not set
# end of Fuses

#
# GPIO
#
CONFIG_DRIVERS_IMX_GPIO=y
# end of GPIO

#
# Memory controllers
#
CONFIG_IMX_FLEXSPI=y
# end of Memory controllers

#
# MMC and SD
#
# CONFIG_MMC_CORE is not set
# CONFIG_IMX_USDHC is not set
# end of MMC and SD

#
# Partition tables
#
# CONFIG_PARTITION_GPT is not set
CONFIG_PARTITION_STATIC=y
# end of Partition tables

CONFIG_DRIVERS_IMX_HAB_LOG=y

#
# Timers
#
CONFIG_DRIVERS_IMX_GPT=y
# end of Timers

CONFIG_HAVE_IMX_LPUART=y

#
# UART
#
CONFIG_DRIVERS_IMX_LPUART=y
# end of UART

CONFIG_HAVE_IMX_CI_UDC=y

#
# USB
#
CONFIG_DRIVER_USB_DEVICE=y
CONFIG_DRIVER_USB_PB_CLS=y
CONFIG_DRIVER_IMX_USB2_PHY=y
CONFIG_DRIVER_IMX_CI_UDC=y
# CONFIG_DRIVER_IMX_USBDCD is not set
# end of USB

#
# Virtio
#
# CONFIG_DRIVER_VIRTIO_BLOCK is not set
# CONFIG_DRIVER_VIRTIO_SERIAL is not set
# end of Virtio

CONFIG_HAVE_IMX_WDOG=y

#
# Watchdog
#
CONFIG_DRIVERS_IMX_WDOG=y
# CONFIG_DRIVERS_IMX_WDOG_DEBUG is not set
# CONFIG_DRIVERS_IMX_WDOG_WAIT is not set
# end of Watchdog
# end of Drivers

#
# Library
#
CONFIG_LIB_DER_HELPERS=y
CONFIG_LIB_FDT=y
# end of Library

#
# Build
#
CONFIG_OPTIMIZE="s"
# CONFIG_DEBUG_SYMBOLS is not set
CONFIG_STACK_SIZE_KiB=4
CONFIG_LINK_FILE="src/link.lds"
# end of Build
```
