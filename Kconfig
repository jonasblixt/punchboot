## plat/imx6ul/Kconfig
```kconfig
menu "imx6ul configuration"
    depends on PLAT_IMX6UL
    comment "Console configuration"


comment "USB Transport"
config EHCI_BASE
    hex "EHCI base address"
    default 0x02184000

comment "CAAM"
config IMX_CAAM_BASE
    hex "CAAM base address"
    default 0x31430000

comment "Watchdog"
config IMX_WATCHDOG_BASE
    hex "Watchdog base"
    default 0x020BC000
    depends on ENABLE_WATCHDOG

comment "Generic timer"
config IMX_GPT_BASE
    hex "IMX timer base"
    default 0x02098000

config IMX_GPT_PR
    int "IMX timer divisor"
    default 24

comment "Debug serial port"

config IMX_UART_BASE
    hex "IMX uart base"
    default 0x021E8000

config IMX_UART_BAUDRATE
    int "IMX uart baudrate"
    default 115200

comment "Fusebox"

config IMX_OCOTP_BASE
    hex "IMX OCOTP base"
    default 0x021BC000

config IMX_OCOTP_WORDS_PER_BANK
    int "Words per bank"
    default 8

config IMX_OCOTP_DEBUG
    bool "Enable OCOTP debug printouts"
    default n
endmenu

menu "Output image"
    depends on PLAT_IMX6UL

config IMX6UL_CREATE_IMX_IMAGE
    bool "Create imx-image"
    default n

config IMX6UL_MKIMAGE_TOOL
    string "mkimage tool"
    default "mkimage_imx8"
    depends on IMX6UL_CREATE_IMX_IMAGE

config IMX6UL_SIGN_IMAGE
    bool "Sign image"
    default n
    depends on IMX6UL_CREATE_IMX_IMAGE

config IMX6UL_CST_TOOL
    string "NXP Signing tool (CST)"
    default "cst"
    depends on IMX6UL_SIGN_IMAGE

config IMX6UL_SRK_TABLE
    string "SRK Table binary"
    default "pki/imx6ul_hab_testkeys/SRK_1_2_3_4_table.bin"
    depends on IMX6UL_SIGN_IMAGE

config IMX6UL_KEY_INDEX
    int "Key index (0-3)"
    default 0
    depends on IMX6UL_SIGN_IMAGE

config IMX6UL_SIGN_CERT
    string "Signing certificate"
    default "pki/imx6ul_hab_testkeys/CSF1_1_sha256_4096_65537_v3_usr_crt.pem"
    depends on IMX6UL_SIGN_IMAGE

config IMX6UL_IMAGE_SIGN_CERT
    string "Signing certificate"
    default "pki/imx6ul_hab_testkeys/IMG1_1_sha256_4096_65537_v3_usr_crt.pem"
    depends on IMX6UL_SIGN_IMAGE
endmenu
```

## plat/imx6ul/Kconfig.include
```kconfig
menu "imx6ul configuration"
    depends on PLAT_IMX6UL
    comment "Console configuration"


comment "USB Transport"
config EHCI_BASE
    hex "EHCI base address"
    default 0x02184000

comment "CAAM"
config IMX_CAAM_BASE
    hex "CAAM base address"
    default 0x31430000

endmenu
```

## plat/imx8m/Kconfig
```kconfig
menu "imx8m configuration"
    depends on PLAT_IMX8M
    comment "Console configuration"


comment "USB Transport"
config DWC3_BASE
    hex "DWC3 base address"
    default 0x38100000

comment "Watchdog"
config IMX_WATCHDOG_BASE
    hex "Watchdog base"
    default 0x30280000
    depends on ENABLE_WATCHDOG

comment "Debug serial port"

config IMX_UART_BASE
    hex "IMX uart base"
    default 0x30860000

config IMX_UART_BAUDRATE
    int "IMX uart baudrate"
    default 115200

comment "Fusebox"

config IMX_OCOTP_BASE
    hex "IMX OCOTP base"
    default 0x30350000

config IMX_OCOTP_WORDS_PER_BANK
    int "Words per bank"
    default 4

config IMX_OCOTP_DEBUG
    bool "Enable OCOTP debug printouts"
    default n

config IMX8M_UMCTL_TRAIN_1D_D
    string "UMCTL 1D Train d-data"
    default "blobs/lpddr4_pmu_train_1d_dmem.bin"

config IMX8M_UMCTL_TRAIN_1D_I
    string "UMCTL 1D Train i-data"
    default "blobs/lpddr4_pmu_train_1d_imem.bin"

config IMX8M_UMCTL_TRAIN_2D_D
    string "UMCTL 2D Train d-data"
    default "blobs/lpddr4_pmu_train_2d_dmem.bin"

config IMX8M_UMCTL_TRAIN_2D_I
    string "UMCTL 2D Train i-data"
    default "blobs/lpddr4_pmu_train_2d_imem.bin"


endmenu

menu "Output image"
    depends on PLAT_IMX8M
config IMX8M_CREATE_IMX_IMAGE
    bool "Create imx-image"
    default n

config IMX8M_SIGN_IMAGE
    bool "Sign image"
    default n
    depends on IMX8M_CREATE_IMX_IMAGE

config IMX8M_SRK_TABLE
    string "SRK Table binary"
    default "pki/imx6ul_hab_testkeys/SRK_1_2_3_4_table.bin"
    depends on IMX8M_SIGN_IMAGE

config IMX8M_KEY_INDEX
    int "Signing key index"
    default 0
    depends on IMX8M_SIGN_IMAGE

config IMX8M_SIGN_CERT
    string "Signing certificate"
    default "pki/imx6ul_hab_testkeys/CSF1_1_sha256_4096_65537_v3_usr_crt.pem"
    depends on IMX8M_SIGN_IMAGE

config IMX8M_IMAGE_SIGN_CERT
    string "Signing certificate"
    default "pki/imx6ul_hab_testkeys/IMG1_1_sha256_4096_65537_v3_usr_crt.pem"
    depends on IMX8M_SIGN_IMAGE
endmenu
```

## plat/imx8x/Kconfig
```kconfig
menu "imx8x configuration"
    depends on PLAT_IMX8X
    comment "imx8x configuration"

choice CONSOLE_UART
	bool "Select console UART"
config CONSOLE_UART0
	bool "UART0"
config CONSOLE_UART1
	bool "UART1"
config CONSOLE_UART2
	bool "UART2"
endchoice
endmenu

menu "Output image"
    depends on PLAT_IMX8X
config IMX8X_CREATE_IMX_IMAGE
    bool "Create imx-image"
    default n

config IMX8X_SIGN_IMAGE
    bool "Sign image"
    default n
    depends on IMX8X_CREATE_IMX_IMAGE
endmenu
```

## plat/imx8x/Kconfig.include
```kconfig
menu "imx8x configuration"
    depends on PLAT_IMX8X
    comment "Console configuration"

config LPUART_BASE
    hex "Console port base address"
    default 0x5A060000

config LPUART_BAUDRATE
    hex "Baudrate setting"
    default 0x402008b

comment "USB Transport"
config EHCI_BASE
    hex "EHCI base address"
    default 0x5b0d0000

comment "CAAM"
config IMX_CAAM_BASE
    hex "CAAM base address"
    default 0x31430000

endmenu
```

## plat/qemu/Kconfig
```kconfig
menu "QEMU platform configuration"

config OVERRIDE_ARCH_JUMP
    bool "Call board specific jump function"
    default n

endmenu
```

## src/board/imx8dxlevk/Kconfig
```kconfig
choice BOARD
    bool "Board"
config BOARD_IMX8DXLMEK
    bool "NXP IMX8DXL evk"
    depends on PLAT_IMX8XL
endchoice
```

## src/drivers/block/Kconfig
```kconfig
menu "Block drivers"

config DRIVERS_BIO_CORE
    bool "Enable support for block devices"
    default y

config DRIVERS_BIO_MAX_DEVS
    int "Maxmum number of block devices"
    default 32
    depends on DRIVERS_BIO_CORE

endmenu
```

## src/drivers/crypto/mbedtls/Kconfig
```kconfig
config MBEDTLS_MD_SHA256
    bool "SHA256"
    default y
    depends on DRIVERS_CRYPTO_MBEDTLS

config MBEDTLS_MD_SHA384
    bool "SHA384"
    default y
    depends on DRIVERS_CRYPTO_MBEDTLS

config MBEDTLS_MD_SHA512
    bool "SHA512"
    default y
    depends on DRIVERS_CRYPTO_MBEDTLS
    select MBEDTLS_MD_SHA384

config MBEDTLS_MD_MD5
    bool "MD5"
    default y
    depends on DRIVERS_CRYPTO_MBEDTLS

config MBEDTLS_ECDSA
    bool "ECDSA"
    default y
    depends on DRIVERS_CRYPTO_MBEDTLS
```
