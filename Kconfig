## Kconfig
```kconfig
mainmenu "Punchboot configuration"

source "arch/Kconfig"
source "plat/Kconfig"
source "arch/*/Kconfig"
source "plat/*/Kconfig"

source "kconfig/Kconfig.board"
source "kconfig/Kconfig.generic"
source "kconfig/Kconfig.build"
source "kconfig/Kconfig.auth"
source "kconfig/Kconfig.boot"
source "kconfig/Kconfig.library"
source "kconfig/Kconfig.transport"
```

## board/Kconfig
```kconfig
choice BOARD
    bool "Board"

config BOARD_IMX8QXMEK
    bool "NXP IMX8X QX MEK"
    depends on PLAT_IMX8X

config BOARD_QEMUARMV7
    bool "QEMU armv7"
    depends on PLAT_QEMU

config BOARD_TEST
    bool "QEMU test"
    depends on PLAT_QEMU

config BOARD_JIFFY
    bool "Jiffy"
    depends on PLAT_IMX6UL

config BOARD_BEBOP
    bool "Bebop"
    depends on PLAT_IMX6UL

config BOARD_PICO8ML
    bool "pico8ml"
    depends on PLAT_IMX8M

config BOARD_IMX8MEVK
    bool "NXP IMX8M EVK"
    depends on PLAT_IMX8M

endchoice
```

## board/imx8qxmek/Kconfig
```kconfig
choice BOARD
    bool "Board"
config BOARD_IMX8QXMEK
    bool "NXP IMX8X QX MEK"
    depends on PLAT_IMX8X
endchoice
```

## configs/bebop_defconfig
```kconfig
# CONFIG_ARCH_ARMV8 is not set
CONFIG_ARCH_ARMV7=y
CONFIG_PLAT_IMX6UL=y
# CONFIG_PLAT_QEMU is not set

#
# imx6ul configuration
#

#
# Console configuration
#

#
# Watchdog
#
CONFIG_IMX_WATCHDOG_BASE=0x020BC000

#
# Debug serial port
#
CONFIG_IMX_UART_BASE=0x021E8000
CONFIG_IMX_UART_BAUDRATE=115200

#
# Fusebox
#
CONFIG_IMX_OCOTP_BASE=0x021BC000
CONFIG_IMX_OCOTP_WORDS_PER_BANK=8
# CONFIG_IMX_OCOTP_DEBUG is not set
# end of imx6ul configuration

#
# Output image
#
CONFIG_IMX6UL_CREATE_IMX_IMAGE=y
CONFIG_IMX6UL_MKIMAGE_TOOL="mkimage"
CONFIG_IMX6UL_SIGN_IMAGE=y
CONFIG_IMX6UL_SRK_TABLE="pki/imx6ul_hab_testkeys/SRK_1_2_3_4_table.bin"
CONFIG_IMX6UL_KEY_INDEX=0
CONFIG_IMX6UL_SIGN_CERT="pki/imx6ul_hab_testkeys/CSF1_1_sha256_4096_65537_v3_usr_crt.pem"
CONFIG_IMX6UL_IMAGE_SIGN_CERT="pki/imx6ul_hab_testkeys/IMG1_1_sha256_4096_65537_v3_usr_crt.pem"
# end of Output image

#
# Generic options
#
CONFIG_KEYSTORE="pki/internal_keystore.bpak"
CONFIG_LOGLEVEL=3
CONFIG_ENABLE_WATCHDOG=y
CONFIG_WATCHDOG_TIMEOUT=5
CONFIG_DUMP_TIMING_ANALYSIS=y
# CONFIG_CALL_BOARD_SLC_SET_CONFIGURATION is not set
# CONFIG_CALL_BOARD_SLC_SET_CONFIGURATION_LOCK is not set
# end of Generic options

#
# Build configuration
#
CONFIG_OPTIMIZE="2"
# CONFIG_DEBUG_SYMBOLS is not set
# CONFIG_STACK_USAGE is not set
CONFIG_STACK_SIZE_KB=8
# end of Build configuration

#
# Authentication
#
# CONFIG_AUTH is not set
# end of Authentication

#
# Command mode transport configuration
#
CONFIG_CMD_BUF_SIZE_KB=4096
CONFIG_TRANSPORT_MAX_CHUNK_KB=4096
CONFIG_LOAD_FS_MAX_CHUNK_KB=4096
CONFIG_TRANSPORT_READY_TIMEOUT=10
# CONFIG_TRANSPORT_ENTER_BOARD_CB is not set
# end of Command mode transport configuration

CONFIG_LIB_UUID3=y
# CONFIG_BEARSSL is not set
```

## configs/imx8qxmek_defconfig
```kconfig
CONFIG_ARCH_ARMV8=y
# CONFIG_ARCH_ARMV7 is not set
CONFIG_ARMV8_EL3=y

#
# Platform support
#
CONFIG_SOC_FAMILY_IMX=y
CONFIG_PLAT_IMX8X=y
# CONFIG_PLAT_IMX8M is not set

#
# imx8x configuration
#

#
# imx8x configuration
#
CONFIG_IMX8X_CONSOLE_UART0=y
# CONFIG_IMX8X_CONSOLE_UART1 is not set
# CONFIG_IMX8X_CONSOLE_UART2 is not set
CONFIG_IMX8X_CONSOLE_BAUDRATE=115200
# end of imx8x configuration

#
# Output image
#
CONFIG_IMX8X_CREATE_IMX_IMAGE=y
CONFIG_IMX8X_SIGN_IMAGE=y
# end of Output image
# end of Platform support

#
# Generic options
#
CONFIG_KEYSTORE="pki/internal_keystore.bpak"
CONFIG_LOGLEVEL=3
CONFIG_ENABLE_WATCHDOG=y
CONFIG_PRINT_BOOT_BANNER=y
CONFIG_WATCHDOG_TIMEOUT=5
CONFIG_ENABLE_TIMESTAMPING=y
CONFIG_PRINT_TIMESTAMPS=y
CONFIG_NO_OF_TIMESTAMPS=64
# CONFIG_CALL_BOARD_SLC_SET_CONFIGURATION is not set
# CONFIG_CALL_BOARD_SLC_SET_CONFIGURATION_LOCK is not set
CONFIG_DEVICE_UUID=y
CONFIG_CRYPTO=y
CONFIG_CRYPTO_MAX_HASH_OPS=1
CONFIG_CRYPTO_MAX_DSA_OPS=1
CONFIG_SELF_TEST=y
# end of Generic options

#
# Build configuration
#
CONFIG_OPTIMIZE="2"
# CONFIG_DEBUG_SYMBOLS is not set
# CONFIG_STACK_USAGE is not set
CONFIG_STACK_SIZE_KB=16
# end of Build configuration

#
# Boot
#
CONFIG_BOOT_CORE=y
CONFIG_BOOT_BPAK_IMAGE_HELPERS=y
CONFIG_BOOT_AB_DRIVER=y
CONFIG_BOOT_LINUX=y
CONFIG_BOOT_LOAD_CHUNK_kB=4096
# end of Boot

#
# Drivers
#

#
# Block drivers
#
CONFIG_DRIVERS_BIO_CORE=y
CONFIG_DRIVERS_BIO_MAX_DEVS=32
# end of Block drivers

#
# Crypto
#
CONFIG_DRIVERS_IMX_CAAM=y
# CONFIG_DRIVERS_CRYPTO_MBEDTLS is not set
# end of Crypto

#
# Fusebox
#
CONFIG_DRIVERS_FUSE_TEST=y
# end of Fusebox

#
# GPIO
#
CONFIG_DRIVERS_IMX_GPIO=y
# end of GPIO

#
# MMC Host drivers
#
CONFIG_MMC_CORE=y
# CONFIG_MMC_CORE_DEBUG_CMDS is not set
# CONFIG_MMC_CORE_DEBUG_IOS is not set
# CONFIG_MMC_CORE_HS200_TUNE is not set
CONFIG_IMX_USDHC=y
# CONFIG_IMX_USDHC_XTRA_DEBUG is not set
# end of MMC Host drivers

#
# Partition table drivers
#
CONFIG_PARTITION_GPT=y
# end of Partition table drivers

#
# Timers
#
CONFIG_DRIVERS_IMX_GPT=y
# end of Timers

#
# Uart
#
CONFIG_DRIVERS_IMX_LPUART=y
# end of Uart

#
# USB
#
CONFIG_DRIVER_USB_DEVICE=y
CONFIG_DRIVER_IMX_USB2_PHY=y
CONFIG_DRIVER_IMX_EHCI=y
# CONFIG_DRIVER_IMX_USBDCD is not set
CONFIG_DRIVER_USB_PB_CLS=y
# end of USB

#
# Virtio
#
# CONFIG_DRIVER_VIRTIO_BLOCK is not set
# CONFIG_DRIVER_VIRTIO_SERIAL is not set
# end of Virtio
# end of Drivers

#
# Command mode
#
CONFIG_CM=y
CONFIG_CM_BUF_SIZE_KB=4096
CONFIG_CM_TRANSPORT_READY_TIMEOUT=10
CONFIG_CM_AUTH=y
CONFIG_CM_AUTH_TOKEN=y
CONFIG_CM_AUTH_PASSWORD=y
# end of Command mode

#
# Library
#
CONFIG_LIB_ZLIB_CRC=y
# CONFIG_LIB_FLETCHER8 is not set
CONFIG_LIB_BPAK=y
CONFIG_LIB_DER_HELPERS=y
CONFIG_LIB_FDT=y
CONFIG_LIB_UUID=y
CONFIG_LIB_UUID3=y
CONFIG_LIB_XLAT_TBLS=y
CONFIG_LIB_XLAT_TBLS_ARMV8=y
# end of Library
```

## configs/pico8ml_defconfig
```kconfig
CONFIG_ARCH_ARMV8=y
# CONFIG_ARCH_ARMV7 is not set
# CONFIG_PLAT_IMX8X is not set
CONFIG_PLAT_IMX8M=y
CONFIG_IMX_WATCHDOG_BASE=0x30280000
CONFIG_IMX_UART_BASE=0x30860000
CONFIG_IMX_UART_BAUDRATE=115200
CONFIG_IMX_OCOTP_BASE=0x30350000
CONFIG_IMX_OCOTP_WORDS_PER_BANK=4
# CONFIG_IMX_OCOTP_DEBUG is not set

#
# imx8m configuration
#

#
# Console configuration
#

#
# USB Transport
#
CONFIG_DWC3_BASE=0x38100000

#
# Watchdog
#

#
# Debug serial port
#

#
# Fusebox
#
CONFIG_IMX8M_UMCTL_TRAIN_1D_D="lpddr4_pmu_train_1d_dmem.bin"
CONFIG_IMX8M_UMCTL_TRAIN_1D_I="lpddr4_pmu_train_1d_imem.bin"
CONFIG_IMX8M_UMCTL_TRAIN_2D_D="lpddr4_pmu_train_2d_dmem.bin"
CONFIG_IMX8M_UMCTL_TRAIN_2D_I="lpddr4_pmu_train_2d_imem.bin"
# end of imx8m configuration

#
# Output image
#
CONFIG_IMX8M_CREATE_IMX_IMAGE=y
CONFIG_IMX8M_SIGN_IMAGE=y
CONFIG_IMX8M_SRK_TABLE="pki/imx6ul_hab_testkeys/SRK_1_2_3_4_table.bin"
CONFIG_IMX8M_KEY_INDEX=0
CONFIG_IMX8M_SIGN_CERT="pki/imx6ul_hab_testkeys/CSF1_1_sha256_4096_65537_v3_usr_crt.pem"
CONFIG_IMX8M_IMAGE_SIGN_CERT="pki/imx6ul_hab_testkeys/IMG1_1_sha256_4096_65537_v3_usr_crt.pem"
# end of Output image

#
# Generic options
#
CONFIG_KEYSTORE="pki/internal_keystore.bpak"
CONFIG_LOGLEVEL=1
CONFIG_ENABLE_WATCHDOG=y
CONFIG_WATCHDOG_TIMEOUT=10
CONFIG_DUMP_TIMING_ANALYSIS=y
# CONFIG_CALL_BOARD_SLC_SET_CONFIGURATION is not set
# CONFIG_CALL_BOARD_SLC_SET_CONFIGURATION_LOCK is not set
# end of Generic options

#
# Build configuration
#
CONFIG_OPTIMIZE="2"
# CONFIG_DEBUG_SYMBOLS is not set
# CONFIG_STACK_USAGE is not set
CONFIG_STACK_SIZE_KB=4
# end of Build configuration

#
# Authentication
#
CONFIG_AUTH=y
CONFIG_AUTH_METHOD_TOKEN=y
# CONFIG_AUTH_METHOD_PASSWORD is not set
# end of Authentication

#
# Command mode transport configuration
#
CONFIG_CMD_BUF_SIZE_KB=4096
CONFIG_TRANSPORT_MAX_CHUNK_KB=4096
CONFIG_LOAD_FS_MAX_CHUNK_KB=4096
CONFIG_TRANSPORT_READY_TIMEOUT=10
# CONFIG_TRANSPORT_ENTER_BOARD_CB is not set
# end of Command mode transport configuration

CONFIG_LIB_UUID3=y
# CONFIG_BEARSSL is not set
```

## configs/qemuarmv7a_defconfig
```kconfig
# CONFIG_ARCH_ARMV8 is not set
CONFIG_ARCH_ARMV7=y
# CONFIG_PLAT_IMX6UL is not set
CONFIG_PLAT_QEMU=y

#
# QEMU platform configuration
#
# CONFIG_OVERRIDE_ARCH_JUMP is not set
CONFIG_QEMU_RAM_MB=1024
CONFIG_QEMU_VIRTIO_DISK="/tmp/disk"
CONFIG_QEMU_VIRTIO_DISK_SIZE_MB=32
# CONFIG_QEMU_ENABLE_TEST_COVERAGE is not set
# end of QEMU platform configuration

#
# Board configuration
#

#
# Generic options
#
CONFIG_KEYSTORE="pki/internal_keystore.bpak"
CONFIG_LOGLEVEL=3
CONFIG_ENABLE_WATCHDOG=y
CONFIG_WATCHDOG_TIMEOUT=5
# CONFIG_CALL_EARLY_PLAT_BOOT is not set
CONFIG_DUMP_TIMING_ANALYSIS=y
# CONFIG_CALL_BOARD_SLC_SET_CONFIGURATION is not set
# CONFIG_CALL_BOARD_SLC_SET_CONFIGURATION_LOCK is not set
# end of Generic options

#
# Build configuration
#
CONFIG_OPTIMIZE="2"
# CONFIG_DEBUG_SYMBOLS is not set
# CONFIG_STACK_USAGE is not set
CONFIG_STACK_SIZE_KB=2
# end of Build configuration

#
# Authentication
#
CONFIG_AUTH=y
CONFIG_AUTH_METHOD_TOKEN=y
# end of Authentication

#
# Boot configuration
#

#
# Boot configuration
#
CONFIG_BOOT_AB=y
CONFIG_BOOT_IMAGE_ID=0xec103b08
CONFIG_BOOT_STATE_PRIMARY_UU="f5f8c9ae-efb5-4071-9ba9-d313b082281e"
CONFIG_BOOT_STATE_BACKUP_UU="656ab3fc-5856-4a5e-a2ae-5a018313b3ee"
# CONFIG_BOOT_DT is not set
# CONFIG_BOOT_RAMDISK is not set
CONFIG_BOOT_AB_A_UUID="2af755d8-8de5-45d5-a862-014cfa735ce0"
CONFIG_BOOT_AB_B_UUID="c046ccd8-0f2e-4036-984d-76c14dc73992"
# end of Boot configuration

#
# Library
#
CONFIG_BEARSSL=y
# end of Library

#
# Command mode transport configuration
#
CONFIG_CMD_BUF_SIZE_KB=4096
CONFIG_TRANSPORT_MAX_CHUNK_KB=4
CONFIG_LOAD_FS_MAX_CHUNK_KB=4096
CONFIG_TRANSPORT_READY_TIMEOUT=10
# end of Command mode transport configuration
```

## configs/test_defconfig
```kconfig
# CONFIG_ARCH_ARMV8 is not set
CONFIG_ARCH_ARMV7=y

#
# Platform support
#
# CONFIG_SOC_FAMILY_IMX is not set
CONFIG_PLAT_QEMU=y

#
# QEMU platform configuration
#
CONFIG_QEMU_RAM_MB=1024
CONFIG_QEMU_VIRTIO_DISK="/tmp/disk"
CONFIG_QEMU_VIRTIO_DISK_SIZE_MB=32
CONFIG_QEMU_ENABLE_TEST_COVERAGE=y
# end of QEMU platform configuration
# end of Platform support

#
# Generic options
#
CONFIG_KEYSTORE="pki/internal_keystore.bpak"
CONFIG_LOGLEVEL=3
CONFIG_ENABLE_WATCHDOG=y
CONFIG_PRINT_BOOT_BANNER=y
CONFIG_WATCHDOG_TIMEOUT=5
# CONFIG_ENABLE_TIMESTAMPING is not set
# CONFIG_CALL_BOARD_SLC_SET_CONFIGURATION is not set
# CONFIG_CALL_BOARD_SLC_SET_CONFIGURATION_LOCK is not set
CONFIG_DEVICE_UUID=y
CONFIG_CRYPTO=y
CONFIG_CRYPTO_MAX_HASH_OPS=1
CONFIG_CRYPTO_MAX_DSA_OPS=1
CONFIG_SELF_TEST=y
# end of Generic options

#
# Build configuration
#
CONFIG_OPTIMIZE="2"
CONFIG_DEBUG_SYMBOLS=y
CONFIG_STACK_USAGE=y
CONFIG_STACK_SIZE_KB=16
# end of Build configuration

#
# Boot
#
CONFIG_BOOT_CORE=y
CONFIG_BOOT_BPAK_IMAGE_HELPERS=y
CONFIG_BOOT_AB_DRIVER=y
CONFIG_BOOT_LINUX=y
CONFIG_BOOT_LOAD_CHUNK_kB=4096
# end of Boot

#
# Drivers
#

#
# Block drivers
#
CONFIG_DRIVERS_BIO_CORE=y
CONFIG_DRIVERS_BIO_MAX_DEVS=32
# end of Block drivers

#
# Crypto
#
CONFIG_DRIVERS_CRYPTO_MBEDTLS=y
CONFIG_MBEDTLS_MD_SHA256=y
CONFIG_MBEDTLS_MD_SHA384=y
CONFIG_MBEDTLS_MD_SHA512=y
CONFIG_MBEDTLS_MD_MD5=y
CONFIG_MBEDTLS_ECDSA=y
# end of Crypto

#
# Fusebox
#
CONFIG_DRIVERS_FUSE_TEST=y
# end of Fusebox

#
# GPIO
#
# end of GPIO

#
# MMC Host drivers
#
# CONFIG_MMC_CORE is not set
# end of MMC Host drivers

#
# Partition table drivers
#
CONFIG_PARTITION_GPT=y
# end of Partition table drivers

#
# Timers
#
# end of Timers

#
# Uart
#
# end of Uart

#
# USB
#
# CONFIG_DRIVER_USB_DEVICE is not set
# end of USB

#
# Virtio
#
CONFIG_DRIVER_VIRTIO_BLOCK=y
CONFIG_DRIVER_VIRTIO_SERIAL=y
# end of Virtio
# end of Drivers

#
# Command mode
#
CONFIG_CM=y
CONFIG_CM_BUF_SIZE_KB=4096
CONFIG_CM_TRANSPORT_READY_TIMEOUT=10
CONFIG_CM_AUTH=y
CONFIG_CM_AUTH_TOKEN=y
CONFIG_CM_AUTH_PASSWORD=y
# end of Command mode

#
# Library
#
CONFIG_LIB_ZLIB_CRC=y
CONFIG_LIB_BPAK=y
CONFIG_LIB_DER_HELPERS=y
CONFIG_LIB_FDT=y
CONFIG_LIB_UUID=y
CONFIG_LIB_UUID3=y
CONFIG_LIB_XLAT_TBLS=y
CONFIG_LIB_XLAT_TBLS_ARMV7=y
# end of Library
```

## kconfig/Kconfig.auth
```kconfig
menu "Authentication"

config AUTH
    bool "Enable command mode authentication"
    default y

choice AUTH_METHOD
    prompt "Authentication method"
    depends on AUTH

config AUTH_METHOD_TOKEN
    bool "Token based authentication"

config AUTH_METHOD_PASSWORD
    bool "Password based authentication"

endchoice

endmenu
```

## kconfig/Kconfig.build
```kconfig
menu "Build configuration"

config OPTIMIZE
    string "Optimize level"

config DEBUG_SYMBOLS
    bool "Enable debug symbols"

config STACK_USAGE
    bool "Generate stack usage information"

endmenu
```

## kconfig/Kconfig.generic
```kconfig
menu "Generic options"

config KEYSTORE
	string "Key-store source"
	default "pki/internal_keystore.bpak"

config LOGLEVEL
	int "loglevel"
    default 0

config ENABLE_WATCHDOG
	bool "Enable watchdog"
    default y

config WATCHDOG_TIMEOUT
    int "Watchdog timeout (s)"
    default 5
    depends on ENABLE_WATCHDOG

config DUMP_TIMING_ANALYSIS
    bool "Dump timing analysis"
    default n
    help
        Print internal timestamps just before jump.
        This is mostly meaningful if loglevel is 0.

config CALL_BOARD_SLC_SET_CONFIGURATION
    bool "Call board_slc_set_configuration"
    default n
    help
        When the SLC configuration command is invoked the platform code also
        calls board_slc_set_configuration.

config CALL_BOARD_SLC_SET_CONFIGURATION_LOCK
    bool "Call board_slc_set_configuration_lock"
    default n
    help
        When the SLC configuration lock command is invoked the platform code also
        calls board_slc_set_configuration_lock.
endmenu
```

## kconfig/Kconfig.transport
```kconfig
menu "Command mode transport configuration"

config CMD_BUF_SIZE_KB
    int "Command buffer size in kB"
    default 4096

config TRANSPORT_MAX_CHUNK_KB
    int "Transport maximum chunk size in kB"
    default 4096

config LOAD_FS_MAX_CHUNK_KB
    int "File system maximum load chunk size (kB)"
    default 4096

config ENABLE_WATCHDOG
	bool "Enable watchdog"
    default y

config TRANSPORT_READY_TIMEOUT
	int "Timeout in seconds before transport must become ready"
    default 10
endmenu
```

## lib/Kconfig
```kconfig
menu "Library"

source "lib/bearssl/Kconfig"

config LIB_UUID3
    bool "Enable UUID3 function"
endmenu
```
